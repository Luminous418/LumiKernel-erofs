/dts-v1/;

/ {
	model = "MT6768";
	compatible = "mediatek,MT6768";
	interrupt-parent = <0x1>;
	#address-cells = <0x2>;
	#size-cells = <0x2>;

	chosen {
		bootargs = "root=/dev/ram vmalloc=400M swiotlb=noforce cgroup.memory=nosocket,nokmem firmware_class.path=/vendor/firmware page_owner=on loop.max_part=7";
		kaslr-seed = <0x0 0x0>;
		phandle = <0x68>;
	};

	cpus {
		#address-cells = <0x1>;
		#size-cells = <0x0>;

		cpu@000 {
			device_type = "cpu";
			compatible = "arm,cortex-a55";
			reg = <0x0>;
			enable-method = "psci";
			clock-frequency = <0x65633340>;
			cpu-idle-states = <0x2 0x3 0x4 0x5 0x6 0x7 0x8>;
			phandle = <0x9>;
		};

		cpu@001 {
			device_type = "cpu";
			compatible = "arm,cortex-a55";
			reg = <0x100>;
			enable-method = "psci";
			clock-frequency = <0x65633340>;
			cpu-idle-states = <0x2 0x3 0x4 0x5 0x6 0x7 0x8>;
			phandle = <0xa>;
		};

		cpu@002 {
			device_type = "cpu";
			compatible = "arm,cortex-a55";
			reg = <0x200>;
			enable-method = "psci";
			clock-frequency = <0x65633340>;
			cpu-idle-states = <0x2 0x3 0x4 0x5 0x6 0x7 0x8>;
			phandle = <0xb>;
		};

		cpu@003 {
			device_type = "cpu";
			compatible = "arm,cortex-a55";
			reg = <0x300>;
			enable-method = "psci";
			clock-frequency = <0x65633340>;
			cpu-idle-states = <0x2 0x3 0x4 0x5 0x6 0x7 0x8>;
			phandle = <0xc>;
		};

		cpu@100 {
			device_type = "cpu";
			compatible = "arm,cortex-a55";
			reg = <0x400>;
			enable-method = "psci";
			clock-frequency = <0x65633340>;
			cpu-idle-states = <0x2 0x3 0x4 0x5 0x6 0x7 0x8>;
			phandle = <0xd>;
		};

		cpu@101 {
			device_type = "cpu";
			compatible = "arm,cortex-a55";
			reg = <0x500>;
			enable-method = "psci";
			clock-frequency = <0x65633340>;
			cpu-idle-states = <0x2 0x3 0x4 0x5 0x6 0x7 0x8>;
			phandle = <0xe>;
		};

		cpu@102 {
			device_type = "cpu";
			compatible = "arm,cortex-a75";
			reg = <0x600>;
			enable-method = "psci";
			clock-frequency = <0x8166d4c0>;
			cpu-idle-states = <0x2 0x3 0x4 0x5 0x6 0x7 0x8>;
			phandle = <0xf>;
		};

		cpu@103 {
			device_type = "cpu";
			compatible = "arm,cortex-a75";
			reg = <0x700>;
			enable-method = "psci";
			clock-frequency = <0x8166d4c0>;
			cpu-idle-states = <0x2 0x3 0x4 0x5 0x6 0x7 0x8>;
			phandle = <0x10>;
		};

		cpu-map {

			cluster0 {

				core0 {
					cpu = <0x9>;
				};

				core1 {
					cpu = <0xa>;
				};

				core2 {
					cpu = <0xb>;
				};

				core3 {
					cpu = <0xc>;
				};

				core4 {
					cpu = <0xd>;
				};

				core5 {
					cpu = <0xe>;
				};

				doe {
					phandle = <0x69>;
				};
			};

			cluster1 {

				core0 {
					cpu = <0xf>;
				};

				core1 {
					cpu = <0x10>;
				};

				doe {
					phandle = <0x6a>;
				};
			};
		};

		idle-states {
			entry-method = "arm,psci";

			standby {
				compatible = "arm,idle-state";
				arm,psci-suspend-param = <0x1>;
				entry-latency-us = <0x258>;
				exit-latency-us = <0x258>;
				min-residency-us = <0x4b0>;
				phandle = <0x2>;
			};

			mcdi-cpu {
				compatible = "arm,idle-state";
				arm,psci-suspend-param = <0x10001>;
				entry-latency-us = <0x258>;
				exit-latency-us = <0x258>;
				min-residency-us = <0x4b0>;
				phandle = <0x3>;
			};

			mcdi-cluster {
				compatible = "arm,idle-state";
				arm,psci-suspend-param = <0x1010001>;
				entry-latency-us = <0x258>;
				exit-latency-us = <0x258>;
				min-residency-us = <0x4b0>;
				phandle = <0x4>;
			};

			idledram {
				compatible = "arm,idle-state";
				arm,psci-suspend-param = <0x1010002>;
				entry-latency-us = <0x320>;
				exit-latency-us = <0x3e8>;
				min-residency-us = <0x7d0>;
				status = "okay";
				phandle = <0x5>;
			};

			idlesyspll {
				compatible = "arm,idle-state";
				arm,psci-suspend-param = <0x1010003>;
				entry-latency-us = <0x320>;
				exit-latency-us = <0x3e8>;
				min-residency-us = <0x7d0>;
				status = "okay";
				phandle = <0x6>;
			};

			idlebus26m {
				compatible = "arm,idle-state";
				arm,psci-suspend-param = <0x1010004>;
				entry-latency-us = <0x320>;
				exit-latency-us = <0x3e8>;
				min-residency-us = <0x7d0>;
				status = "okay";
				phandle = <0x7>;
			};

			suspend {
				compatible = "arm,idle-state";
				arm,psci-suspend-param = <0x1010005>;
				entry-latency-us = <0x320>;
				exit-latency-us = <0x3e8>;
				min-residency-us = <0x7d0>;
				phandle = <0x8>;
			};
		};
	};

	cache_parity {
		compatible = "mediatek,cache_parity";
		version = <0x1>;
		reg = <0x0 0xc530000 0x0 0x10000>;
		err_level = <0x1>;
		irq_config = <0x0 0x8090 0xff00 0x8090 0x44 0x8090 0xff 0x1 0x8090 0xff00 0x8090 0x44 0x8090 0xff 0x2 0x8090 0xff00 0x8090 0x44 0x8090 0xff 0x3 0x8090 0xff00 0x8090 0x44 0x8090 0xff 0x4 0x8090 0xff00 0x8090 0x44 0x8090 0xff 0x5 0x8090 0xff00 0x8090 0x44 0x8090 0xff 0x6 0x8090 0xff00 0x8090 0x44 0x8090 0xff 0x7 0x8090 0xff00 0x8090 0x44 0x8090 0xff 0x400 0xc8c0 0x1000000 0xc8c0 0xc 0xc8c8 0x1>;
		interrupts = <0x0 0x16 0x4 0x0 0x17 0x4 0x0 0x18 0x4 0x0 0x19 0x4 0x0 0x1a 0x4 0x0 0x1b 0x4 0x0 0x1c 0x4 0x0 0x1d 0x4 0x0 0x13 0x4>;
	};

	memory {
		device_type = "memory";
		reg = <0x0 0x40000000 0x0 0x3e605000>;
	};

	psci {
		compatible = "arm,psci-1.0";
		method = "smc";
	};

	mobicore {
		compatible = "trustonic,mobicore";
		interrupts = <0x0 0x129 0x1>;
	};

	teegris {
		compatible = "samsung,teegris";
		interrupts = <0x0 0x106 0x8 0x0 0x107 0x8>;
	};

	tee_sanity {
		compatible = "mediatek,tee_sanity";
		interrupts = <0x0 0x12a 0x1>;
	};

	utos {
		compatible = "microtrust,utos";
		interrupts = <0x0 0x12b 0x1 0x0 0x12c 0x1>;
	};

	utos_tester {
		compatible = "microtrust,tester-v1";
	};

	pmu {
		compatible = "arm,armv8-pmuv3";
		interrupt-parent = <0x11>;
		interrupts = <0x1 0x7 0x8>;
	};

	dsu-pmu-0 {
		compatible = "arm,dsu-pmu";
		interrupts = <0x0 0x12 0x4>;
		cpus = <0x9 0xa 0xb 0xc 0xd 0xe 0xf 0x10>;
	};

	reserved-memory {
		#address-cells = <0x2>;
		#size-cells = <0x2>;
		ranges;
		phandle = <0x6b>;

		sec-log-reserve-memory@0x46C00000 {
			reg = <0x0 0x46c00000 0x0 0x200000>;
		};

		sec-lastklog@0x46E00000 {
			reg = <0x0 0x46e00000 0x0 0x200000>;
		};

		sec-logger-reserve-memory@0x47000000 {
			reg = <0x0 0x47000000 0x0 0x400000>;
		};

		sec-autocomment-reserve-memory@0x47400000 {
			reg = <0x0 0x47400000 0x0 0x10000>;
		};

		sec-extrainfo-reserve-memory@0x47410000 {
			reg = <0x0 0x47410000 0x0 0x1f0000>;
		};

		sec-initlog-reserve-memory@0x47600000 {
			reg = <0x0 0x47600000 0x0 0x200000>;
		};

		reserve-memory-ssmr {
			compatible = "mediatek,reserve-memory-ssmr";
			no-map;
			size = <0x0 0x1000>;
			alignment = <0x0 0x1000>;
			alloc-ranges = <0x0 0xc0000000 0x4 0x0>;
		};

		zmc-default {
			compatible = "mediatek,zone_movable_cma";
			size = <0x0 0x40000000>;
			alignment = <0x0 0x1000000>;
			alloc-ranges = <0x0 0xc0000000 0x4 0x0>;
		};

		cccimdee-reserved-memory@0x4AE3E000 {
			compatible = "mediatek,ccci-md-ee-dump";
			reg = <0x0 0x4ae3e000 0x0 0x1c2000>;
		};

		reserve-memory-sspm_share {
			compatible = "mediatek,reserve-memory-sspm_share";
			no-map;
			status = "okay";
			size = <0x0 0x510000>;
			alignment = <0x0 0x10000>;
			alloc-ranges = <0x0 0x40000000 0x0 0x60000000>;
		};

		reserve-memory-scp_share {
			compatible = "mediatek,reserve-memory-scp_share";
			no-map;
			size = <0x0 0x300000>;
			alignment = <0x0 0x1000000>;
			alloc-ranges = <0x0 0x40000000 0x0 0x50000000>;
		};

		ion-carveout-heap {
			compatible = "mediatek,ion-carveout-heap";
			no-map;
			size = <0x0 0x9000>;
			alignment = <0x0 0x1000>;
			alloc-ranges = <0x0 0xc0000000 0x4 0x0>;
		};

		consys-reserve-memory {
			compatible = "mediatek,consys-reserve-memory";
			no-map;
			size = <0x0 0x440000>;
			alignment = <0x0 0x1000000>;
			alloc-ranges = <0x0 0x40000000 0x0 0x80000000>;
		};

		wifi-reserve-memory {
			compatible = "shared-dma-pool";
			no-map;
			size = <0x0 0x300000>;
			alignment = <0x0 0x1000000>;
			alloc-ranges = <0x0 0x40000000 0x0 0x80000000>;
			phandle = <0x61>;
		};
	};

	cpu_dbgapb@0e010000 {
		compatible = "mediatek,hw_dbg";
		num = <0x8>;
		reg = <0x0 0xe010000 0x0 0x1000 0x0 0xe110000 0x0 0x1000 0x0 0xe210000 0x0 0x1000 0x0 0xe310000 0x0 0x1000 0x0 0xe410000 0x0 0x1000 0x0 0xe510000 0x0 0x1000 0x0 0xe610000 0x0 0x1000 0x0 0xe710000 0x0 0x1000>;
		phandle = <0x6c>;
	};

	interrupt-controller {
		compatible = "arm,gic-v3";
		#interrupt-cells = <0x3>;
		#address-cells = <0x2>;
		#size-cells = <0x2>;
		#redistributor-regions = <0x1>;
		interrupt-parent = <0x11>;
		interrupt-controller;
		reg = <0x0 0xc000000 0x0 0x40000 0x0 0xc040000 0x0 0x200000 0x0 0xc53a650 0x0 0x50>;
		interrupts = <0x1 0x9 0x4>;
		phandle = <0x11>;
	};

	intpol-controller@0 {
		compatible = "mediatek,mt6577-sysirq";
		interrupt-controller;
		#interrupt-cells = <0x3>;
		interrupt-parent = <0x11>;
		reg = <0x0 0xc53a650 0x0 0x50>;
		phandle = <0x1>;
	};

	chipid@08000000 {
		compatible = "mediatek,chipid";
		reg = <0x0 0x8000000 0x0 0x4 0x0 0x8000004 0x0 0x4 0x0 0x8000008 0x0 0x4 0x0 0x800000c 0x0 0x4>;
	};

	timer {
		compatible = "arm,armv8-timer";
		interrupt-parent = <0x11>;
		interrupts = <0x1 0xd 0x8 0x1 0xe 0x8 0x1 0xb 0x8 0x1 0xa 0x8>;
		clock-frequency = <0xc65d40>;
		phandle = <0x6d>;
	};

	infracfg_ao@10001000 {
		compatible = "mediatek,infracfg_ao", "syscon";
		reg = <0x0 0x10001000 0x0 0x1000>;
		interrupts = <0x0 0x47 0x1>;
		#clock-cells = <0x1>;
		phandle = <0x21>;
	};

	scpsys@10001000 {
		compatible = "mediatek,scpsys", "syscon";
		reg = <0x0 0x10001000 0x0 0x1000 0x0 0x10006000 0x0 0x1000 0x0 0x14002000 0x0 0x1000 0x0 0x1020e000 0x0 0x1000 0x0 0x18004000 0x0 0x1000 0x0 0x18002000 0x0 0x1000 0x0 0x10000000 0x0 0x1000 0x0 0x16000000 0x0 0x1000 0x0 0x16025000 0x0 0x1000>;
		#clock-cells = <0x1>;
		phandle = <0x22>;
	};

	mcdi@0010fc00 {
		compatible = "mediatek,mt6768-mcdi";
		mediatek,enabled = <0x1>;
		reg = <0x0 0x10fc00 0x0 0x800 0x0 0xc53a000 0x0 0x1000>;
		phandle = <0x6e>;
	};

	scp@10500000 {
		compatible = "mediatek,scp";
		status = "okay";
		reg = <0x0 0x10500000 0x0 0x80000 0x0 0x105c0000 0x0 0x3000 0x0 0x105c4000 0x0 0x1000 0x0 0x105d4000 0x0 0x6000>;
		interrupts = <0x0 0xcd 0x4>;
		core_1 = "enable";
		scp_sramSize = <0x80000>;
	};

	scp_dvfs {
		compatible = "mediatek,scp_dvfs";
		clocks = <0x12 0x53 0x13 0x12 0xe 0x12 0x1a 0x12 0x2 0x12 0x17 0x12 0x6 0x12 0x19>;
		clock-names = "clk_mux", "clk_pll_0", "clk_pll_1", "clk_pll_2", "clk_pll_3", "clk_pll_4", "clk_pll_5", "clk_pll_6";
	};

	topckgen@10000000 {
		compatible = "mediatek,topckgen", "syscon";
		reg = <0x0 0x10000000 0x0 0x1000>;
		#clock-cells = <0x1>;
		phandle = <0x12>;
	};

	io_cfg_lt@10002000 {
		compatible = "mediatek,io_cfg_lt";
		reg = <0x0 0x10002000 0x0 0x200>;
		phandle = <0x15>;
	};

	io_cfg_lm@10002200 {
		compatible = "mediatek,io_cfg_lm";
		reg = <0x0 0x10002200 0x0 0x200>;
		phandle = <0x16>;
	};

	io_cfg_lb@10002400 {
		compatible = "mediatek,io_cfg_lb";
		reg = <0x0 0x10002400 0x0 0x200>;
		phandle = <0x17>;
	};

	io_cfg_bl@10002600 {
		compatible = "mediatek,io_cfg_bl";
		reg = <0x0 0x10002600 0x0 0x200>;
		phandle = <0x18>;
	};

	io_cfg_rm@10002800 {
		compatible = "mediatek,io_cfg_rm";
		reg = <0x0 0x10002800 0x0 0x200>;
		phandle = <0x19>;
	};

	io_cfg_rb@10002a00 {
		compatible = "mediatek,io_cfg_rb";
		reg = <0x0 0x10002a00 0x0 0x200>;
		phandle = <0x1a>;
	};

	io_cfg_rt@10002c00 {
		compatible = "mediatek,io_cfg_rt";
		reg = <0x0 0x10002c00 0x0 0x200>;
		phandle = <0x1b>;
	};

	io_cfg_tl@10002e00 {
		compatible = "mediatek,io_cfg_tl";
		reg = <0x0 0x10002e00 0x0 0x200>;
		phandle = <0x1c>;
	};

	pericfg@10003000 {
		compatible = "mediatek,pericfg", "syscon";
		reg = <0x0 0x10003000 0x0 0x1000>;
		#clock-cells = <0x1>;
		phandle = <0x32>;
	};

	efuse_dbg@10004000 {
		compatible = "mediatek,efuse_dbg";
		reg = <0x0 0x10004000 0x0 0x1000>;
	};

	gpio@10005000 {
		compatible = "mediatek,gpio";
		reg = <0x0 0x10005000 0x0 0x1000>;
		phandle = <0x14>;
	};

	pinctrl {
		compatible = "mediatek,mt6768-pinctrl";
		reg_bases = <0x14 0x15 0x16 0x17 0x18 0x19 0x1a 0x1b 0x1c>;
		reg_base_eint = <0x1d>;
		pins-are-numbered;
		gpio-controller;
		gpio-ranges = <0x1e 0x0 0x0 0xba>;
		#gpio-cells = <0x2>;
		interrupt-controller;
		interrupts = <0x0 0xba 0x4>;
		#interrupt-cells = <0x4>;
		phandle = <0x1e>;

		aud_clk_mosi_off {
			phandle = <0x41>;

			pins_cmd0_dat {
				pinmux = <0x8800>;
				bias-pull-down;
			};

			pins_cmd1_dat {
				pinmux = <0x8900>;
				bias-pull-down;
			};
		};

		aud_clk_mosi_on {
			phandle = <0x42>;

			pins_cmd0_dat {
				pinmux = <0x8801>;
				input-schmitt-enable;
				bias-disable;
			};

			pins_cmd1_dat {
				pinmux = <0x8901>;
				input-schmitt-enable;
				bias-disable;
			};
		};

		aud_clk_miso_off {
			phandle = <0x43>;

			pins_cmd0_dat {
				pinmux = <0x8c00>;
				bias-pull-down;
			};

			pins_cmd1_dat {
				pinmux = <0x8d00>;
				bias-pull-down;
			};
		};

		aud_clk_miso_on {
			phandle = <0x44>;

			pins_cmd0_dat {
				pinmux = <0x8c01>;
				input-schmitt-enable;
				bias-disable;
			};

			pins_cmd1_dat {
				pinmux = <0x8d01>;
				input-schmitt-enable;
				bias-disable;
			};
		};

		aud_dat_mosi_off {
			phandle = <0x45>;

			pins_cmd0_dat {
				pinmux = <0x8800>;
				slew-rate = <0x0>;
				bias-pull-down;
			};

			pins_cmd1_dat {
				pinmux = <0x8900>;
				input-enable;
				slew-rate = <0x0>;
				bias-pull-down;
			};

			pins_cmd2_dat {
				pinmux = <0x8a00>;
				input-enable;
				slew-rate = <0x0>;
				bias-pull-down;
			};

			pins_cmd3_dat {
				pinmux = <0x8b00>;
				input-enable;
				slew-rate = <0x0>;
				bias-pull-down;
			};
		};

		aud_dat_mosi_on {
			phandle = <0x46>;

			pins_cmd0_dat {
				pinmux = <0x8801>;
				input-schmitt-enable;
				bias-disable;
			};

			pins_cmd1_dat {
				pinmux = <0x8901>;
				input-schmitt-enable;
				bias-disable;
			};

			pins_cmd2_dat {
				pinmux = <0x8a01>;
				input-schmitt-enable;
				bias-disable;
			};

			pins_cmd3_dat {
				pinmux = <0x8b01>;
				input-schmitt-enable;
				bias-disable;
			};
		};

		aud_dat_miso_off {
			phandle = <0x47>;

			pins_cmd0_dat {
				pinmux = <0x8c00>;
				input-enable;
				slew-rate = <0x0>;
				bias-pull-down;
			};

			pins_cmd1_dat {
				pinmux = <0x8d00>;
				input-enable;
				slew-rate = <0x0>;
				bias-pull-down;
			};

			pins_cmd2_dat {
				pinmux = <0x8e00>;
				input-enable;
				slew-rate = <0x0>;
				bias-pull-down;
			};

			pins_cmd3_dat {
				pinmux = <0x8f00>;
				input-enable;
				slew-rate = <0x0>;
				bias-pull-down;
			};
		};

		aud_dat_miso_on {
			phandle = <0x48>;

			pins_cmd0_dat {
				pinmux = <0x8c01>;
				input-schmitt-enable;
				bias-disable;
			};

			pins_cmd1_dat {
				pinmux = <0x8d01>;
				input-schmitt-enable;
				bias-disable;
			};

			pins_cmd2_dat {
				pinmux = <0x8e01>;
				input-schmitt-enable;
				bias-disable;
			};

			pins_cmd3_dat {
				pinmux = <0x8f01>;
				input-schmitt-enable;
				bias-disable;
			};
		};

		aud_gpio_i2s0_off {
			phandle = <0x49>;

			pins_cmd_dat {
				pinmux = <0x2800>;
			};
		};

		aud_gpio_i2s0_on {
			phandle = <0x4a>;

			pins_cmd_dat {
				pinmux = <0x2802>;
			};
		};

		aud_gpio_i2s1_off {
			phandle = <0x4b>;
		};

		aud_gpio_i2s1_on {
			phandle = <0x4c>;
		};

		aud_gpio_i2s2_off {
			phandle = <0x4d>;
		};

		aud_gpio_i2s2_on {
			phandle = <0x4e>;
		};

		aud_gpio_i2s3_off {
			phandle = <0x4f>;

			pins_cmd_dat {
				pinmux = <0x2500 0x2600 0x2400>;
			};
		};

		aud_gpio_i2s3_on {
			phandle = <0x50>;

			pins_cmd_dat {
				pinmux = <0x2502 0x2602 0x2402>;
			};
		};

		vow_dat_miso_off {
			phandle = <0x51>;

			pins_cmd1_dat {
				pinmux = <0x8e00>;
			};
		};

		vow_dat_miso_on {
			phandle = <0x52>;

			pins_cmd1_dat {
				pinmux = <0x8e04>;
			};
		};

		vow_clk_miso_off {
			phandle = <0x53>;

			pins_cmd3_dat {
				pinmux = <0x8f00>;
			};
		};

		vow_clk_miso_on {
			phandle = <0x54>;

			pins_cmd3_dat {
				pinmux = <0x8f04>;
			};
		};

		msdc0@default {
			phandle = <0x33>;

			pins_cmd {
				drive-strength = [03];
			};

			pins_dat {
				drive-strength = [03];
			};

			pins_clk {
				drive-strength = [03];
			};

			pins_rst {
				drive-strength = [03];
			};

			pins_ds {
				drive-strength = [03];
			};
		};

		msdc0@hs400 {
			phandle = <0x34>;

			pins_cmd {
				drive-strength = [03];
			};

			pins_dat {
				drive-strength = [04];
			};

			pins_clk {
				drive-strength = [04];
			};

			pins_rst {
				drive-strength = [03];
			};

			pins_ds {
				drive-strength = [04];
			};
		};

		msdc0@hs200 {
			phandle = <0x35>;

			pins_cmd {
				drive-strength = [03];
			};

			pins_dat {
				drive-strength = [04];
			};

			pins_clk {
				drive-strength = [04];
			};

			pins_rst {
				drive-strength = [03];
			};

			pins_ds {
				drive-strength = [04];
			};
		};

		msdc0@register_default {
			cmd_edge = [00];
			rdata_edge = [00];
			wdata_edge = [00];
			phandle = <0x36>;
		};

		msdc1@default {
			phandle = <0x38>;

			pins_cmd {
				drive-strength = [03];
			};

			pins_dat {
				drive-strength = [03];
			};

			pins_clk {
				drive-strength = [03];
			};
		};

		msdc1@sdr104 {
			phandle = <0x39>;

			pins_cmd {
				drive-strength = [03];
			};

			pins_dat {
				drive-strength = [03];
			};

			pins_clk {
				drive-strength = [03];
			};
		};

		msdc1@sdr50 {
			phandle = <0x3a>;

			pins_cmd {
				drive-strength = [03];
			};

			pins_dat {
				drive-strength = [03];
			};

			pins_clk {
				drive-strength = [03];
			};
		};

		msdc1@ddr50 {
			phandle = <0x3b>;

			pins_cmd {
				drive-strength = [03];
			};

			pins_dat {
				drive-strength = [03];
			};

			pins_clk {
				drive-strength = [03];
			};
		};

		msdc1@register_default {
			cmd_edge = [00];
			rdata_edge = [00];
			wdata_edge = [00];
			phandle = <0x3c>;
		};
	};

	sleep@10006000 {
		compatible = "mediatek,sleep";
		reg = <0x0 0x10006000 0x0 0x1000>;
		interrupts = <0x0 0xc3 0x8>;
		phandle = <0x6f>;
	};

	toprgu@10007000 {
		compatible = "mediatek,toprgu";
		reg = <0x0 0x10007000 0x0 0x1000>;
		interrupts = <0x0 0x9c 0x8>;
		phandle = <0x70>;
	};

	clocks {

		clk26m {
			compatible = "fixed-clock";
			#clock-cells = <0x0>;
			clock-frequency = <0x18cba80>;
			phandle = <0x13>;
		};

		clk32k {
			compatible = "fixed-clock";
			#clock-cells = <0x0>;
			clock-frequency = <0x7d00>;
			phandle = <0x1f>;
		};
	};

	dcm {
		compatible = "mediatek,dcm";
		phandle = <0x71>;
	};

	apxgpt@10008000 {
		compatible = "mediatek,apxgpt";
		reg = <0x0 0x10008000 0x0 0x1000>;
		interrupts = <0x0 0xb9 0x8>;
		clocks = <0x1f>;
	};

	hacc@1000a000 {
		compatible = "mediatek,hacc";
		reg = <0x0 0x1000a000 0x0 0x1000>;
		interrupts = <0x0 0xcb 0x8>;
	};

	apirq@1000b000 {
		compatible = "mediatek,apirq";
		reg = <0x0 0x1000b000 0x0 0x1000>;
		interrupts = <0x0 0xba 0x4>;
		phandle = <0x1d>;
	};

	apmixed@1000c000 {
		compatible = "mediatek,apmixed", "syscon";
		reg = <0x0 0x1000c000 0x0 0x1000>;
		#clock-cells = <0x1>;
		phandle = <0x3f>;
	};

	fhctl@1000ce00 {
		compatible = "mediatek,fhctl";
		reg = <0x0 0x1000ce00 0x0 0x200>;
	};

	pwrap@1000d000 {
		compatible = "mediatek,mt6768-pwrap";
		reg = <0x0 0x1000d000 0x0 0x1000>;
		reg-names = "pwrap";
		interrupts = <0x0 0xc2 0x4>;
		clocks = <0x13 0x13>;
		clock-names = "spi", "wrap";
		phandle = <0x20>;

		mt6358-pmic {
			compatible = "mediatek,mt6358-pmic";
			interrupt-parent = <0x1e>;
			interrupts = <0x90 0x4 0x90 0x0>;
			status = "okay";
			interrupt-controller;
			#interrupt-cells = <0x2>;
			mediatek,num-pmic-irqs = <0x91>;
			mediatek,pmic-irqs = <0x0 0x0 0x1 0x0 0x2 0x0 0x3 0x0 0x4 0x0 0x5 0x0 0x6 0x0 0x7 0x0 0x8 0x0 0x9 0x0 0x10 0x1 0x11 0x1 0x12 0x1 0x13 0x1 0x14 0x1 0x15 0x1 0x16 0x1 0x17 0x1 0x18 0x1 0x19 0x1 0x1a 0x1 0x1b 0x1 0x1c 0x1 0x1d 0x1 0x1e 0x1 0x1f 0x1 0x20 0x1 0x21 0x1 0x22 0x1 0x23 0x1 0x24 0x1 0x25 0x1 0x26 0x1 0x27 0x1 0x28 0x1 0x29 0x1 0x2a 0x1 0x2b 0x1 0x2c 0x1 0x2d 0x1 0x2e 0x1 0x30 0x2 0x31 0x2 0x32 0x2 0x33 0x2 0x34 0x2 0x35 0x2 0x36 0x2 0x37 0x2 0x40 0x3 0x50 0x4 0x51 0x4 0x52 0x4 0x53 0x4 0x54 0x4 0x55 0x4 0x56 0x4 0x57 0x4 0x58 0x4 0x59 0x4 0x5a 0x4 0x5b 0x4 0x5c 0x4 0x60 0x4 0x61 0x4 0x62 0x4 0x63 0x4 0x64 0x4 0x70 0x5 0x71 0x5 0x72 0x5 0x73 0x5 0x74 0x5 0x75 0x5 0x76 0x5 0x77 0x5 0x80 0x6 0x85 0x6 0x86 0x6 0x87 0x6 0x90 0x7>;
			interrupt-names = "vproc11_oc", "vproc12_oc", "vcore_oc", "vgpu_oc", "vmodem_oc", "vdram1_oc", "vs1_oc", "vs2_oc", "vpa_oc", "vcore_preoc", "vfe28_oc", "vxo22_oc", "vrf18_oc", "vrf12_oc", "vefuse_oc", "vcn33_oc", "vcn28_oc", "vcn18_oc", "vcama1_oc", "vcama2_oc", "vcamd_oc", "vcamio_oc", "vldo28_oc", "va12_oc", "vaux18_oc", "vaud28_oc", "vio28_oc", "vio18_oc", "vsram_proc11_oc", "vsram_proc12_oc", "vsram_others_oc", "vsram_gpu_oc", "vdram2_oc", "vmc_oc", "vmch_oc", "vemc_oc", "vsim1_oc", "vsim2_oc", "vibr_oc", "vusb_oc", "vbif28_oc", "pwrkey", "homekey", "pwrkey_r", "homekey_r", "ni_lbat_int", "chrdet", "chrdet_edge", "vcdt_hv_det", "rtc", "fg_bat0_h", "fg_bat0_l", "fg_cur_h", "fg_cur_l", "fg_zcv", "fg_bat1_h", "fg_bat1_l", "fg_n_charge_l", "fg_iavg_h", "fg_iavg_l", "fg_time_h", "fg_discharge", "fg_charge", "baton_lv", "baton_ht", "baton_bat_in", "baton_bat_out", "bif", "bat_h", "bat_l", "bat2_h", "bat2_l", "bat_temp_h", "bat_temp_l", "auxadc_imp", "nag_c_dltv", "audio", "accdet", "accdet_eint0", "accdet_eint1", "spi_cmd_alert";
			phandle = <0x72>;

			mt-pmic {
				compatible = "mediatek,mt-pmic";
				interrupts = <0x30 0x4 0x32 0x4 0x31 0x4 0x33 0x4 0x70 0x4 0x71 0x4 0x52 0x4 0x53 0x4>;
				interrupt-names = "pwrkey", "pwrkey_r", "homekey", "homekey_r", "bat_h", "bat_l", "fg_cur_h", "fg_cur_l";
				phandle = <0x73>;
			};

			mt635x-auxadc {
				compatible = "mediatek,mt6358-auxadc";
				#io-channel-cells = <0x1>;
				phandle = <0x74>;

				batadc {
					channel = <0x0>;
					resistance-ratio = <0x3 0x1>;
					avg-num = <0x80>;
				};

				vcdt {
					channel = <0x2>;
				};

				bat_temp {
					channel = <0x3>;
					resistance-ratio = <0x2 0x1>;
				};

				chip_temp {
					channel = <0x5>;
				};

				vcore_temp {
					channel = <0x6>;
				};

				vproc_temp {
					channel = <0x7>;
				};

				vgpu_temp {
					channel = <0x8>;
				};

				accdet {
					channel = <0x9>;
				};

				dcxo_volt {
					channel = <0xa>;
					resistance-ratio = <0x3 0x2>;
				};

				tsx_temp {
					channel = <0xb>;
					avg-num = <0x80>;
				};

				hpofs_cal {
					channel = <0xc>;
					avg-num = <0x100>;
				};

				dcxo_temp {
					channel = <0xd>;
					avg-num = <0x10>;
				};

				vbif {
					channel = <0xe>;
					resistance-ratio = <0x2 0x1>;
				};
			};

			mt6358regulator {
				compatible = "mediatek,mt6358-regulator";
				phandle = <0x75>;

				buck_vdram1 {
					regulator-name = "vdram1";
					regulator-min-microvolt = <0x7a120>;
					regulator-max-microvolt = <0x1fda4c>;
					regulator-enable-ramp-delay = <0x0>;
					phandle = <0x76>;
				};

				buck_vcore {
					regulator-name = "vcore";
					regulator-min-microvolt = <0x7a120>;
					regulator-max-microvolt = <0x13bdb6>;
					regulator-enable-ramp-delay = <0xc8>;
					phandle = <0x77>;
				};

				buck_vpa {
					regulator-name = "vpa";
					regulator-min-microvolt = <0x7a120>;
					regulator-max-microvolt = <0x37b1d0>;
					regulator-enable-ramp-delay = <0xfa>;
					phandle = <0x78>;
				};

				buck_vproc11 {
					regulator-name = "vproc11";
					regulator-min-microvolt = <0x7a120>;
					regulator-max-microvolt = <0x13bdb6>;
					regulator-enable-ramp-delay = <0xc8>;
					phandle = <0x79>;
				};

				buck_vproc12 {
					regulator-name = "vproc12";
					regulator-min-microvolt = <0x7a120>;
					regulator-max-microvolt = <0x13bdb6>;
					regulator-enable-ramp-delay = <0xc8>;
					phandle = <0x7a>;
				};

				buck_vgpu {
					regulator-name = "vgpu";
					regulator-min-microvolt = <0x7a120>;
					regulator-max-microvolt = <0x13bdb6>;
					regulator-enable-ramp-delay = <0xc8>;
					phandle = <0x7b>;
				};

				buck_vs2 {
					regulator-name = "vs2";
					regulator-min-microvolt = <0x7a120>;
					regulator-max-microvolt = <0x1fda4c>;
					regulator-enable-ramp-delay = <0x0>;
					phandle = <0x7c>;
				};

				buck_vmodem {
					regulator-name = "vmodem";
					regulator-min-microvolt = <0x7a120>;
					regulator-max-microvolt = <0x13bdb6>;
					regulator-enable-ramp-delay = <0x384>;
					phandle = <0x7d>;
				};

				buck_vs1 {
					regulator-name = "vs1";
					regulator-min-microvolt = <0xf4240>;
					regulator-max-microvolt = <0x277b6c>;
					regulator-enable-ramp-delay = <0x0>;
					phandle = <0x7e>;
				};

				ldo_vdram2 {
					regulator-name = "vdram2";
					regulator-min-microvolt = <0x927c0>;
					regulator-max-microvolt = <0x1b7740>;
					regulator-enable-ramp-delay = <0xce4>;
					phandle = <0x7f>;
				};

				ldo_vsim1 {
					regulator-name = "vsim1";
					regulator-min-microvolt = <0x19f0a0>;
					regulator-max-microvolt = <0x2f4d60>;
					regulator-enable-ramp-delay = <0x21c>;
					phandle = <0x80>;
				};

				ldo_vibr {
					regulator-name = "vibr";
					regulator-min-microvolt = <0x124f80>;
					regulator-max-microvolt = <0x325aa0>;
					regulator-enable-ramp-delay = <0x3c>;
					phandle = <0x81>;
				};

				ldo_vrf12 {
					compatible = "regulator-fixed";
					regulator-name = "vrf12";
					regulator-min-microvolt = <0x124f80>;
					regulator-max-microvolt = <0x124f80>;
					regulator-enable-ramp-delay = <0x78>;
					phandle = <0x82>;
				};

				ldo_vio18 {
					compatible = "regulator-fixed";
					regulator-name = "vio18";
					regulator-min-microvolt = <0x1b7740>;
					regulator-max-microvolt = <0x1b7740>;
					regulator-enable-ramp-delay = <0xa8c>;
					phandle = <0x83>;
				};

				ldo_vusb {
					regulator-name = "vusb";
					regulator-min-microvolt = <0x2dc6c0>;
					regulator-max-microvolt = <0x2f4d60>;
					regulator-enable-ramp-delay = <0x10e>;
					phandle = <0x84>;
				};

				ldo_vcamio {
					compatible = "regulator-fixed";
					regulator-name = "vcamio";
					regulator-min-microvolt = <0x1b7740>;
					regulator-max-microvolt = <0x1b7740>;
					regulator-enable-ramp-delay = <0x10e>;
					phandle = <0x85>;
				};

				ldo_vcamd {
					regulator-name = "vcamd";
					regulator-min-microvolt = <0xdbba0>;
					regulator-max-microvolt = <0x1b7740>;
					regulator-enable-ramp-delay = <0x10e>;
					phandle = <0x86>;
				};

				ldo_vcn18 {
					compatible = "regulator-fixed";
					regulator-name = "vcn18";
					regulator-min-microvolt = <0x1b7740>;
					regulator-max-microvolt = <0x1b7740>;
					regulator-enable-ramp-delay = <0x10e>;
					phandle = <0x87>;
				};

				ldo_vfe28 {
					compatible = "regulator-fixed";
					regulator-name = "vfe28";
					regulator-min-microvolt = <0x2ab980>;
					regulator-max-microvolt = <0x2ab980>;
					regulator-enable-ramp-delay = <0x10e>;
					phandle = <0x88>;
				};

				ldo_vsram_proc11 {
					regulator-name = "vsram_proc11";
					regulator-min-microvolt = <0x7a120>;
					regulator-max-microvolt = <0x13bdb6>;
					regulator-enable-ramp-delay = <0xf0>;
					phandle = <0x89>;
				};

				ldo_vcn28 {
					compatible = "regulator-fixed";
					regulator-name = "vcn28";
					regulator-min-microvolt = <0x2ab980>;
					regulator-max-microvolt = <0x2ab980>;
					regulator-enable-ramp-delay = <0x10e>;
					phandle = <0x8a>;
				};

				ldo_vsram_others {
					regulator-name = "vsram_others";
					regulator-min-microvolt = <0x7a120>;
					regulator-max-microvolt = <0x13bdb6>;
					regulator-enable-ramp-delay = <0xf0>;
					phandle = <0x8b>;
				};

				ldo_vsram_gpu {
					regulator-name = "vsram_gpu";
					regulator-min-microvolt = <0x7a120>;
					regulator-max-microvolt = <0x13bdb6>;
					regulator-enable-ramp-delay = <0xf0>;
					phandle = <0x8c>;
				};

				ldo_vxo22 {
					compatible = "regulator-fixed";
					regulator-name = "vxo22";
					regulator-min-microvolt = <0x2191c0>;
					regulator-max-microvolt = <0x2191c0>;
					regulator-enable-ramp-delay = <0x78>;
					phandle = <0x8d>;
				};

				ldo_vefuse {
					regulator-name = "vefuse";
					regulator-min-microvolt = <0x19f0a0>;
					regulator-max-microvolt = <0x1cfde0>;
					regulator-enable-ramp-delay = <0x10e>;
					phandle = <0x8e>;
				};

				ldo_vaux18 {
					compatible = "regulator-fixed";
					regulator-name = "vaux18";
					regulator-min-microvolt = <0x1b7740>;
					regulator-max-microvolt = <0x1b7740>;
					regulator-enable-ramp-delay = <0x10e>;
					phandle = <0x8f>;
				};

				ldo_vmch {
					regulator-name = "vmch";
					regulator-min-microvolt = <0x2c4020>;
					regulator-max-microvolt = <0x325aa0>;
					regulator-enable-ramp-delay = <0x3c>;
					phandle = <0x3d>;
				};

				ldo_vbif28 {
					compatible = "regulator-fixed";
					regulator-name = "vbif28";
					regulator-min-microvolt = <0x2ab980>;
					regulator-max-microvolt = <0x2ab980>;
					regulator-enable-ramp-delay = <0x10e>;
					phandle = <0x90>;
				};

				ldo_vsram_proc12 {
					regulator-name = "vsram_proc12";
					regulator-min-microvolt = <0x7a120>;
					regulator-max-microvolt = <0x13bdb6>;
					regulator-enable-ramp-delay = <0xf0>;
					phandle = <0x91>;
				};

				ldo_vcama1 {
					regulator-name = "vcama1";
					regulator-min-microvolt = <0x1b7740>;
					regulator-max-microvolt = <0x2dc6c0>;
					regulator-enable-ramp-delay = <0x10e>;
					phandle = <0x92>;
				};

				ldo_vemc {
					regulator-name = "vemc";
					regulator-min-microvolt = <0x2c4020>;
					regulator-max-microvolt = <0x325aa0>;
					regulator-enable-ramp-delay = <0x3c>;
					phandle = <0x37>;
				};

				ldo_vio28 {
					compatible = "regulator-fixed";
					regulator-name = "vio28";
					regulator-min-microvolt = <0x2ab980>;
					regulator-max-microvolt = <0x2ab980>;
					regulator-enable-ramp-delay = <0x10e>;
					phandle = <0x93>;
				};

				ldo_va12 {
					compatible = "regulator-fixed";
					regulator-name = "va12";
					regulator-min-microvolt = <0x124f80>;
					regulator-max-microvolt = <0x124f80>;
					regulator-enable-ramp-delay = <0x10e>;
					phandle = <0x94>;
				};

				ldo_vrf18 {
					compatible = "regulator-fixed";
					regulator-name = "vrf18";
					regulator-min-microvolt = <0x1b7740>;
					regulator-max-microvolt = <0x1b7740>;
					regulator-enable-ramp-delay = <0x78>;
					phandle = <0x95>;
				};

				ldo_vcn33_bt {
					regulator-name = "vcn33_bt";
					regulator-min-microvolt = <0x325aa0>;
					regulator-max-microvolt = <0x3567e0>;
					regulator-enable-ramp-delay = <0x10e>;
					phandle = <0x96>;
				};

				ldo_vcn33_wifi {
					regulator-name = "vcn33_wifi";
					regulator-min-microvolt = <0x325aa0>;
					regulator-max-microvolt = <0x3567e0>;
					regulator-enable-ramp-delay = <0x10e>;
					phandle = <0x97>;
				};

				ldo_vcama2 {
					regulator-name = "vcama2";
					regulator-min-microvolt = <0x2dc6c0>;
					regulator-max-microvolt = <0x2dc6c0>;
					regulator-enable-ramp-delay = <0x10e>;
					phandle = <0x98>;
				};

				ldo_vmc {
					regulator-name = "vmc";
					regulator-min-microvolt = <0x1b7740>;
					regulator-max-microvolt = <0x325aa0>;
					regulator-enable-ramp-delay = <0x3c>;
					phandle = <0x3e>;
				};

				ldo_vldo28 {
					regulator-name = "vldo28";
					regulator-min-microvolt = <0x2ab980>;
					regulator-max-microvolt = <0x2dc6c0>;
					regulator-enable-ramp-delay = <0x10e>;
					phandle = <0x99>;
				};

				ldo_vaud28 {
					compatible = "regulator-fixed";
					regulator-name = "vaud28";
					regulator-min-microvolt = <0x2ab980>;
					regulator-max-microvolt = <0x2ab980>;
					regulator-enable-ramp-delay = <0x10e>;
					phandle = <0x9a>;
				};

				ldo_vsim2 {
					regulator-name = "vsim2";
					regulator-min-microvolt = <0x19f0a0>;
					regulator-max-microvolt = <0x2f4d60>;
					regulator-enable-ramp-delay = <0x21c>;
					phandle = <0x9b>;
				};

				ldo_va09 {
					compatible = "regulator-fixed";
					regulator-name = "va09";
					regulator-min-microvolt = <0xdbba0>;
					regulator-max-microvolt = <0xdbba0>;
					regulator-enable-ramp-delay = <0x108>;
					regulator-boot-on;
					phandle = <0x9c>;
				};
			};

			mt6358_rtc {
				compatible = "mediatek,mt6358-rtc";
				interrupts = <0x40 0x0>;
				interrupt-names = "rtc";
				base = <0x580>;
				apply-lpsd-solution;
				phandle = <0x9d>;
			};

			mt6358_misc {
				compatible = "mediatek,mt6358-misc";
				base = <0x580>;
				apply-lpsd-solution;
				dcxo-switch;
				phandle = <0x9e>;
			};
		};
	};

	pwraphal@ {
		compatible = "mediatek,pwraph";
		mediatek,pwrap-regmap = <0x20>;
		phandle = <0x9f>;
	};

	pwrap_mpu@1000d000 {
		compatible = "mediatek,pwrap_mpu";
		reg = <0x0 0x1000d000 0x0 0x1000>;
	};

	pwrap_p2p@1005cb000 {
		compatible = "mediatek,pwrap_p2p";
		reg = <0x0 0x105cb000 0x0 0x1000>;
	};

	pwrap_md32@10448000 {
		compatible = "mediatek,pwrap_md32";
		reg = <0x0 0x10448000 0x0 0x1000>;
	};

	sleep_reg_md@1000f000 {
		compatible = "mediatek,sleep_reg_md";
		reg = <0x0 0x1000f000 0x0 0x1000>;
	};

	kp@10010000 {
		compatible = "mediatek,kp";
		reg = <0x0 0x10010000 0x0 0x1000>;
		interrupts = <0x0 0x49 0x2>;
		phandle = <0xa0>;
	};

	mrdump_ext_rst {
		compatible = "mediatek, mrdump_ext_rst-eint";
		force_mode = "SYSRST";
		mode = "RST";
		status = "okay";
		phandle = <0xa1>;
	};

	topmisc@10011000 {
		compatible = "mediatek,topmisc";
		reg = <0x0 0x10011000 0x0 0x1000>;
	};

	dvfsrc@10012000 {
		compatible = "mediatek,dvfsrc";
		reg = <0x0 0x10012000 0x0 0x1000 0x0 0x110780 0x0 0x80>;
		phandle = <0xa2>;
	};

	mbist_ao@10013000 {
		compatible = "mediatek,mbist_ao";
		reg = <0x0 0x10013000 0x0 0x1000>;
	};

	apcldmain_ao@10014000 {
		compatible = "mediatek,apcldmain_ao";
		reg = <0x0 0x10014000 0x0 0x400>;
	};

	apcldmaout_ao@10014400 {
		compatible = "mediatek,apcldmaout_ao";
		reg = <0x0 0x10014400 0x0 0x400>;
	};

	apcldmamisc_ao@10014800 {
		compatible = "mediatek,apcldmamisc_ao";
		reg = <0x0 0x10014800 0x0 0x400>;
	};

	apcldmamisc_ao@10014c00 {
		compatible = "mediatek,apcldmamisc_ao";
		reg = <0x0 0x10014c00 0x0 0x400>;
	};

	ddrphy@10015000 {
		compatible = "mediatek,ddrphy";
		reg = <0x0 0x10015000 0x0 0x1000>;
	};

	aes_top0@10016000 {
		compatible = "mediatek,aes_top0";
		reg = <0x0 0x10016000 0x0 0x1000>;
	};

	sys_timer@10017000 {
		compatible = "mediatek,sys_timer";
		reg = <0x0 0x10017000 0x0 0x1000>;
		reg-names = "sys_timer_base";
		interrupts = <0x0 0xcf 0x4>;
		clocks = <0x12 0x86>;
	};

	modem_temp_share@10018000 {
		compatible = "mediatek,modem_temp_share";
		reg = <0x0 0x10018000 0x0 0x1000>;
	};

	security_ao@1001a000 {
		compatible = "mediatek,security_ao";
		reg = <0x0 0x1001a000 0x0 0x1000>;
	};

	topckgen_ao@1001b000 {
		compatible = "mediatek,topckgen_ao";
		reg = <0x0 0x1001b000 0x0 0x1000>;
	};

	iocfg_0@10002000 {
		compatible = "mediatek,iocfg_0";
		reg = <0x0 0x10002000 0x0 0x200>;
	};

	iocfg_1@10002200 {
		compatible = "mediatek,iocfg_1";
		reg = <0x0 0x10002200 0x0 0x200>;
	};

	iocfg_2@10002400 {
		compatible = "mediatek,iocfg_2";
		reg = <0x0 0x10002400 0x0 0x200>;
	};

	iocfg_3@10002600 {
		compatible = "mediatek,iocfg_3";
		reg = <0x0 0x10002600 0x0 0x200>;
	};

	iocfg_4@10002800 {
		compatible = "mediatek,iocfg_4";
		reg = <0x0 0x10002800 0x0 0x200>;
	};

	iocfg_5@10002a00 {
		compatible = "mediatek,iocfg_5";
		reg = <0x0 0x10002a00 0x0 0x200>;
	};

	mdcldmain_ao@10015000 {
		compatible = "mediatek,mdcldmain_ao";
		reg = <0x0 0x10015000 0x0 0x400>;
	};

	mdcldmaout_ao@10015400 {
		compatible = "mediatek,mdcldmaout_ao";
		reg = <0x0 0x10015400 0x0 0x400>;
	};

	mdcldmamisc_ao@10015800 {
		compatible = "mediatek,mdcldmamisc_ao";
		reg = <0x0 0x10015800 0x0 0x400>;
	};

	sys_cirq@10204000 {
		compatible = "mediatek,sys_cirq";
		reg = <0x0 0x10204000 0x0 0x1000>;
		mediatek,cirq_num = <0xe8>;
		mediatek,spi_start_offset = <0x40>;
		interrupts = <0x0 0x127 0x8>;
	};

	mcucfg_mp0_counter@0c530000 {
		compatible = "mediatek,mcucfg_mp0_counter";
		reg = <0x0 0xc530000 0x0 0x10000>;
	};

	mcucfg@0c530000 {
		compatible = "mediatek,mcucfg";
		reg = <0x0 0xc530000 0x0 0x10000>;
		phandle = <0xa3>;
	};

	m4u@10205000 {
		cell-index = <0x0>;
		compatible = "mediatek,m4u";
		reg = <0x0 0x10205000 0x0 0x1000>;
		interrupts = <0x0 0xae 0x8>;
	};

	devapc@10207000 {
		compatible = "mediatek,mt6768-devapc";
		reg = <0x0 0x10207000 0x0 0x1000 0x0 0x1000e000 0x0 0x1000 0x0 0x10033000 0x0 0x1000 0x0 0x10c000 0x0 0x1000>;
		interrupts = <0x0 0x9f 0x8>;
		clocks = <0x21 0x28>;
		clock-names = "devapc-infra-clock";
	};

	hwrng {
		compatible = "mediatek,mt67xx-rng";
		phandle = <0xa4>;
	};

	bus_dbg@10208000 {
		compatible = "mediatek,bus_dbg-v2";
		reg = <0x0 0x10208000 0x0 0x1000 0x0 0x10001000 0x0 0x1000>;
		mediatek,bus_dbg_con_offset = <0x2fc>;
		interrupts = <0x0 0x9e 0x8>;
	};

	ap_ccif0@10209000 {
		compatible = "mediatek,ap_ccif0";
		reg = <0x0 0x10209000 0x0 0x1000>;
		interrupts = <0x0 0xa4 0x8>;
	};

	md_ccif0@1020a000 {
		compatible = "mediatek,md_ccif0";
		reg = <0x0 0x1020a000 0x0 0x1000>;
	};

	ap_ccif1@1020b000 {
		compatible = "mediatek,ap_ccif1";
		reg = <0x0 0x1020b000 0x0 0x1000>;
		interrupts = <0x0 0xa6 0x8>;
	};

	md_ccif1@1020c000 {
		compatible = "mediatek,md_ccif1";
		reg = <0x0 0x1020c000 0x0 0x1000>;
	};

	infra_mbist@1020d000 {
		compatible = "mediatek,infra_mbist";
		reg = <0x0 0x1020d000 0x0 0x1000>;
	};

	infracfg@1020e000 {
		compatible = "mediatek,infracfg";
		reg = <0x0 0x1020e000 0x0 0x1000>;
	};

	trng@1020f000 {
		compatible = "mediatek,trng";
		reg = <0x0 0x1020f000 0x0 0x1000>;
		interrupts = <0x0 0xb0 0x8>;
	};

	dxcc_sec@10210000 {
		compatible = "mediatek,dxcc_sec";
		reg = <0x0 0x10210000 0x0 0x1000>;
		interrupts = <0x0 0xb1 0x4>;
	};

	mcupm_sram2@10211000 {
		compatible = "mediatek,mcupm_sram2";
		reg = <0x0 0x10211000 0x0 0x1000>;
	};

	cq_dma@10212000 {
		compatible = "mediatek,mt-cqdma-v1";
		reg = <0x0 0x10212000 0x0 0x80 0x0 0x10212080 0x0 0x80 0x0 0x10212100 0x0 0x80>;
		interrupts = <0x0 0x86 0x8 0x0 0x87 0x8 0x0 0x88 0x8>;
		nr_channel = <0x3>;
		clocks = <0x21 0x43>;
		clock-names = "cqdma";
	};

	mcupm_sram3@10213000 {
		compatible = "mediatek,mcupm_sram3";
		reg = <0x0 0x10213000 0x0 0x1000>;
	};

	sramrom@10214000 {
		compatible = "mediatek,sramrom";
		reg = <0x0 0x10214000 0x0 0x1000>;
	};

	mcupm_reg@10216000 {
		compatible = "mediatek,mcupm_reg";
		reg = <0x0 0x10216000 0x0 0x1000>;
	};

	mcupm_sram0@10217000 {
		compatible = "mediatek,mcupm_sram0";
		reg = <0x0 0x10217000 0x0 0x1000>;
	};

	mcupm_sram1@10218000 {
		compatible = "mediatek,mcupm_sram1";
		reg = <0x0 0x10218000 0x0 0x1000>;
	};

	emi@10219000 {
		compatible = "mediatek,emi";
		reg = <0x0 0x10219000 0x0 0x1000 0x0 0x10226000 0x0 0x1000 0x0 0x1022d000 0x0 0x1000 0x0 0x10235000 0x0 0x1000 0x0 0x1020e000 0x0 0x1000>;
		interrupts = <0x0 0xa1 0x8>;
	};

	chn_emi@1021a000 {
		compatible = "mediatek,chn_emi";
		reg = <0x0 0x1021a000 0x0 0x1000>;
	};

	apcldmain@1021b000 {
		compatible = "mediatek,apcldmain";
		reg = <0x0 0x1021b000 0x0 0x100>;
	};

	apcldmain@1021b100 {
		compatible = "mediatek,apcldmain";
		reg = <0x0 0x1021b100 0x0 0x100>;
	};

	apcldmaout@1021b400 {
		compatible = "mediatek,apcldmaout";
		reg = <0x0 0x1021b400 0x0 0x100>;
	};

	apcldmaout@1021b500 {
		compatible = "mediatek,apcldmaout";
		reg = <0x0 0x1021b500 0x0 0x100>;
	};

	apcldmamisc@1021b800 {
		compatible = "mediatek,apcldmamisc";
		reg = <0x0 0x1021b800 0x0 0x100>;
		interrupts = <0x0 0xb4 0x4>;
	};

	apcldmamisc@1021b900 {
		compatible = "mediatek,apcldmamisc";
		reg = <0x0 0x1021b900 0x0 0x400>;
	};

	mdcldmain@1021c000 {
		compatible = "mediatek,mdcldmain";
		reg = <0x0 0x1021c000 0x0 0x400>;
	};

	mdcldmaout@1021c400 {
		compatible = "mediatek,mdcldmaout";
		reg = <0x0 0x1021c400 0x0 0x400>;
	};

	mdcldmamisc@1021c000 {
		compatible = "mediatek,mdcldmamisc";
		reg = <0x0 0x1021c000 0x0 0x1000>;
	};

	mdcldmamisc@1021c900 {
		compatible = "mediatek,mdcldmamisc";
		reg = <0x0 0x1021c900 0x0 0x400>;
	};

	mdcldma@10014000 {
		compatible = "mediatek,mdcldma";
		reg = <0x0 0x10014000 0x0 0x1000 0x0 0x1021b000 0x0 0x1000 0x0 0x10209000 0x0 0x1000 0x0 0x1020a000 0x0 0x1000>;
		interrupts = <0x0 0xb4 0x4 0x0 0xa4 0x8 0x0 0xa5 0x8 0x0 0x4b 0x2>;
		mediatek,md_id = <0x0>;
		mediatek,cldma_capability = <0x6>;
		clocks = <0x22 0x0 0x21 0x32 0x21 0x29 0x21 0x2c 0x21 0x23 0x21 0x24 0x21 0x51 0x21 0x52>;
		clock-names = "scp-sys-md1-main", "infra-cldma-bclk", "infra-ccif-ap", "infra-ccif-md", "infra-ccif1-ap", "infra-ccif1-md", "infra-ccif2-ap", "infra-ccif2-md";
		phandle = <0xa5>;
	};

	md_auxadc {
		compatible = "mediatek,md_auxadc";
		io-channels = <0x23 0x2>;
		io-channel-names = "md-channel";
		phandle = <0xa6>;
	};

	bpi_bsi_slv0@1021e000 {
		compatible = "mediatek,bpi_bsi_slv0";
		reg = <0x0 0x1021e000 0x0 0x1000>;
	};

	bpi_bsi_slv1@1021f000 {
		compatible = "mediatek,bpi_bsi_slv1";
		reg = <0x0 0x1021f000 0x0 0x6000>;
	};

	bpi_bsi_slv2@10225000 {
		compatible = "mediatek,bpi_bsi_slv2";
		reg = <0x0 0x10225000 0x0 0x1000>;
	};

	emi_mpu@10226000 {
		compatible = "mediatek,emi_mpu";
		reg = <0x0 0x10226000 0x0 0x1000>;
	};

	dvfsp@10227000 {
		compatible = "mediatek,dvfsp";
		reg = <0x0 0x10227000 0x0 0x1000>;
	};

	dvfsp@00110800 {
		compatible = "mediatek,mt6768-dvfsp";
		reg = <0x0 0x110800 0x0 0x1400 0x0 0x110800 0x0 0x1400>;
		state = <0x1>;
		change_flag = <0x0>;
		little-rise-time = <0x3e8>;
		little-down-time = <0x2ee>;
		big-rise-time = <0x3e8>;
		big-down-time = <0x2ee>;
		L-table = <0x6a4 0x38 0x2 0x1 0x659 0x35 0x2 0x1 0x5dc 0x30 0x2 0x1 0x5aa 0x2e 0x2 0x1 0x55f 0x2b 0x2 0x1 0x52d 0x29 0x2 0x1 0x4fb 0x27 0x2 0x1 0x497 0x22 0x2 0x1 0x44c 0x29 0x2 0x1 0x41a 0x1d 0x2 0x1 0x3e7 0x1b 0x2 0x1 0x3b6 0x19 0x2 0x1 0x384 0x17 0x2 0x1 0x352 0x15 0x4 0x1 0x306 0x13 0x4 0x1 0x1f4 0x10 0x4 0x1>;
		B-table = <0x7d0 0x48 0x1 0x1 0x79e 0x45 0x1 0x1 0x76c 0x41 0x1 0x1 0x73a 0x3d 0x1 0x1 0x708 0x3a 0x1 0x1 0x6ae 0x36 0x1 0x1 0x655 0x32 0x1 0x1 0x60c 0x30 0x2 0x1 0x5a3 0x2b 0x2 0x1 0x54a 0x27 0x2 0x1 0x4f1 0x24 0x2 0x1 0x498 0x20 0x2 0x1 0x43f 0x1d 0x2 0x1 0x3e6 0x19 0x2 0x1 0x38d 0x16 0x2 0x1 0x352 0x13 0x2 0x1>;
		CCI-table = <0x4a3 0x38 0x2 0x1 0x460 0x34 0x2 0x1 0x419 0x30 0x2 0x1 0x3f6 0x2e 0x2 0x1 0x3c1 0x2b 0x2 0x1 0x38d 0x28 0x2 0x1 0x358 0x24 0x2 0x1 0x335 0x22 0x2 0x1 0x300 0x1f 0x2 0x1 0x2dd 0x1d 0x4 0x1 0x2ba 0x1b 0x4 0x1 0x297 0x19 0x4 0x1 0x274 0x17 0x4 0x1 0x251 0x15 0x4 0x1 0x3a 0x13 0x4 0x1 0x1f4 0x10 0x4 0x1>;
		phandle = <0xa7>;
	};

	mt_cpufreq {
		compatible = "mediatek,mt-cpufreq";
		phandle = <0xa8>;
	};

	dramc@1022a000 {
		compatible = "mediatek,dramc";
		reg = <0x0 0x1022a000 0x0 0x2000 0x0 0x10232000 0x0 0x2000 0x0 0x1022c000 0x0 0x1000 0x0 0x10234000 0x0 0x1000 0x0 0x10228000 0x0 0x2000 0x0 0x10230000 0x0 0x2000 0x0 0x1022e000 0x0 0x1000 0x0 0x10236000 0x0 0x1000>;
	};

	gce@10238000 {
		compatible = "mediatek,gce", "syscon";
		reg = <0x0 0x10238000 0x0 0x4000>;
		#clock-cells = <0x1>;
		interrupts = <0x0 0xaa 0x8>;
		disp_mutex_reg = <0x14016000 0x1000>;
		g3d_config_base = <0x13000000 0x0 0xffff0000>;
		mmsys_config_base = <0x14000000 0x1 0xffff0000>;
		mipitx0_base = <0x11c80000 0x63 0xffff0000>;
		disp_dither_base = <0x14010000 0x2 0xffff0000>;
		mm_na_base = <0x14020000 0x3 0xffff0000>;
		imgsys_base = <0x15020000 0x4 0xffff0000>;
		vdec_gcon_base = <0x18800000 0x5 0xffff0000>;
		venc_gcon_base = <0x18810000 0x6 0xffff0000>;
		conn_peri_base = <0x18820000 0x7 0xffff0000>;
		topckgen_base = <0x18830000 0x8 0xffff0000>;
		kp_base = <0x18840000 0x9 0xffff0000>;
		scp_sram_base = <0x10000000 0xa 0xffff0000>;
		infra_na3_base = <0x10010000 0xb 0xffff0000>;
		infra_na4_base = <0x10020000 0xc 0xffff0000>;
		scp_base = <0x10030000 0xd 0xffff0000>;
		mcucfg_base = <0x10040000 0xe 0xffff0000>;
		gcpu_base = <0x10050000 0xf 0xffff0000>;
		usb0_base = <0x10200000 0x10 0xffff0000>;
		usb_sif_base = <0x10280000 0x11 0xffff0000>;
		audio_base = <0x17000000 0x12 0xffff0000>;
		vdec_base = <0x17010000 0x13 0xffff0000>;
		msdc2_base = <0x17020000 0x14 0xffff0000>;
		vdec1_base = <0x17030000 0x15 0xffff0000>;
		msdc3_base = <0x18000000 0x16 0xffff0000>;
		ap_dma_base = <0x18010000 0x17 0xffff0000>;
		gce_base = <0x18020000 0x18 0xffff0000>;
		vdec2_base = <0x18040000 0x19 0xffff0000>;
		vdec3_base = <0x18050000 0x1a 0xffff0000>;
		camsys_base = <0x18080000 0x1b 0xffff0000>;
		camsys1_base = <0x180a0000 0x1c 0xffff0000>;
		camsys2_base = <0x180b0000 0x1d 0xffff0000>;
		pwm_sw_base = <0x1100e000 0x63 0xffff0000>;
		mdp_rdma0_sof = <0x0>;
		mdp_ccorr0_sof = <0x1>;
		mdp_rsz0_sof = <0x2>;
		mdp_rsz1_sof = <0x3>;
		mdp_wdma_sof = <0x4>;
		mdp_wrot0_sof = <0x5>;
		mdp_tdshp0_sof = <0x6>;
		disp_ovl0_sof = <0x7>;
		disp_2l_ovl0_sof = <0x8>;
		disp_rdma0_sof = <0x9>;
		disp_wdma0_sof = <0xa>;
		disp_color0_sof = <0xb>;
		disp_ccorr0_sof = <0xc>;
		disp_aal0_sof = <0xd>;
		disp_gamma0_sof = <0xe>;
		disp_dither0_sof = <0xf>;
		disp_dsi0_sof = <0x10>;
		disp_rsz0_sof = <0x11>;
		img_dl_relay_sof = <0x12>;
		disp_pwm0_sof = <0x13>;
		mdp_rdma0_frame_done = <0x14>;
		mdp_ccorr0_frame_done = <0x15>;
		mdp_rsz0_frame_done = <0x16>;
		mdp_rsz1_frame_done = <0x17>;
		mdp_wrot0_write_frame_done = <0x18>;
		mdp_wdma_frame_done = <0x19>;
		mdp_tdshp0_frame_done = <0x1a>;
		disp_ovl0_frame_done = <0x1b>;
		disp_2l_ovl0_frame_done = <0x1c>;
		disp_rsz0_frame_done = <0x1d>;
		disp_rdma0_frame_done = <0x1e>;
		disp_wdma0_frame_done = <0x1f>;
		disp_color0_frame_done = <0x20>;
		disp_ccorr0_frame_done = <0x21>;
		disp_aal0_frame_done = <0x22>;
		disp_gamma0_frame_done = <0x23>;
		disp_dither0_frame_done = <0x24>;
		disp_dsi0_frame_done = <0x25>;
		stream_done_0 = <0x82>;
		stream_done_1 = <0x83>;
		stream_done_2 = <0x84>;
		stream_done_3 = <0x85>;
		stream_done_4 = <0x86>;
		stream_done_5 = <0x87>;
		stream_done_6 = <0x88>;
		stream_done_7 = <0x89>;
		stream_done_8 = <0x8a>;
		stream_done_9 = <0x8b>;
		buf_underrun_event_0 = <0x8c>;
		dsi0_te_event = <0x8d>;
		dsi0_irq_event = <0x8e>;
		dsi0_done_event = <0x8f>;
		disp_wdma0_rst_done = <0x93>;
		mdp_wdma_rst_done = <0x94>;
		mdp_wrot0_rst_done = <0x95>;
		mdp_rdma0_rst_done = <0x97>;
		disp_ovl0_frame_rst_done_pusle = <0x98>;
		dip_cq_thread0_frame_done = <0x101>;
		dip_cq_thread1_frame_done = <0x102>;
		dip_cq_thread2_frame_done = <0x103>;
		dip_cq_thread3_frame_done = <0x104>;
		dip_cq_thread4_frame_done = <0x105>;
		dip_cq_thread5_frame_done = <0x106>;
		dip_cq_thread6_frame_done = <0x107>;
		dip_cq_thread7_frame_done = <0x108>;
		dip_cq_thread8_frame_done = <0x109>;
		dip_cq_thread9_frame_done = <0x10a>;
		dip_cq_thread10_frame_done = <0x10b>;
		dip_cq_thread11_frame_done = <0x10c>;
		dip_cq_thread12_frame_done = <0x10d>;
		dip_cq_thread13_frame_done = <0x10e>;
		dip_cq_thread14_frame_done = <0x10f>;
		dip_cq_thread15_frame_done = <0x110>;
		dip_cq_thread16_frame_done = <0x111>;
		dip_cq_thread17_frame_done = <0x112>;
		dip_cq_thread18_frame_done = <0x113>;
		dve_frame_done = <0x114>;
		wmf_frame_done = <0x115>;
		rsc_frame_done = <0x116>;
		venc_frame_done = <0x121>;
		venc_pause_done = <0x122>;
		jpgenc_done = <0x123>;
		venc_mb_done = <0x124>;
		venc_128byte_cnt_done = <0x125>;
		isp_frame_done_b = <0x142>;
		camsv_0_pass1_done = <0x143>;
		camsv_1_pass1_done = <0x144>;
		camsv_2_pass1_done = <0x145>;
		tsf_done = <0x146>;
		seninf_0_fifo_full = <0x147>;
		seninf_1_fifo_full = <0x148>;
		seninf_2_fifo_full = <0x149>;
		seninf_3_fifo_full = <0x14a>;
		seninf_4_fifo_full = <0x14b>;
		seninf_5_fifo_full = <0x14c>;
		seninf_6_fifo_full = <0x14d>;
		seninf_7_fifo_full = <0x14e>;
		dsi0_te_from_infra = <0x382>;
		mmsys_config = <0x24>;
		mdp_rdma0 = <0x25>;
		mdp_rsz0 = <0x26>;
		mdp_rsz1 = <0x27>;
		mdp_wdma0 = <0x28>;
		mdp_wrot0 = <0x29>;
		mdp_tdshp0 = <0x2a>;
		mdp_color0 = <0x2b>;
		mdp_ccorr0 = <0x2c>;
		mm_mutex = <0x2d>;
		sram_share_cnt = <0x1>;
		sram_share_engine = <0xd>;
		sram_share_event = <0x2c6>;
		mediatek,mailbox-gce = <0x2e>;
		secure_thread = <0x6 0x9>;
		mboxes = <0x2e 0x0 0x0 0x4 0x2e 0x2 0x0 0x5 0x2e 0x3 0x0 0x4 0x2e 0x4 0x0 0x4 0x2e 0x6 0x0 0x3 0x2e 0x7 0xffffffff 0x2 0x2f 0x8 0x0 0x4 0x2f 0x9 0x0 0x4 0x2f 0xa 0x0 0x1 0x2f 0xb 0x0 0x1 0x2e 0xc 0x0 0x1 0x2e 0xd 0x0 0x1 0x2e 0xe 0x0 0x1 0x2e 0xf 0xffffffff 0x1>;
		clocks = <0x21 0x9 0x21 0x18 0x22 0x3>;
		clock-names = "GCE", "GCE_TIMER", "MMSYS_MTCMOS";
		gce_mbox_bdg = <0x30>;
		phandle = <0xa9>;
	};

	gce_mbox@10238000 {
		compatible = "mediatek,mt6768-gce";
		reg = <0x0 0x10238000 0x0 0x4000>;
		interrupts = <0x0 0xaa 0x8>;
		default_tokens = [02 bc 02 bd 02 be 02 bf 02 c0 02 c6 02 c7];
		clocks = <0x21 0x9 0x21 0x18>;
		clock-names = "gce", "gce-timer";
		#mbox-cells = <0x3>;
		#gce-event-cells = <0x1>;
		#gce-subsys-cells = <0x2>;
		phandle = <0x2e>;
	};

	gce_mbox_bdg {
		compatible = "mediatek,mailbox-gce-bdg";
		#mbox-cells = <0x3>;
		#gce-event-cells = <0x1>;
		#gce-subsys-cells = <0x2>;
		mboxes = <0x30 0x14 0x0 0x2 0x30 0x15 0x0 0x1>;
		phandle = <0x30>;
	};

	cmdq-bdg-test {
		compatible = "mediatek,cmdq-bdg-test";
		mediatek,gce = <0x30>;
		mboxes = <0x30 0x16 0x0 0x2 0x30 0x17 0x0 0x1>;
		token_user0 = [02 89];
		token_gpr_set4 = [02 c0];
	};

	gce_mbox_svp@10238000 {
		compatible = "mediatek,mailbox-gce-svp";
		reg = <0x0 0x10238000 0x0 0x4000>;
		interrupts = <0x0 0xaa 0x8 0x0 0xab 0x8>;
		#mbox-cells = <0x3>;
		clocks = <0x21 0x9 0x21 0x18>;
		clock-names = "gce", "gce-timer";
		phandle = <0x2f>;
	};

	ktf-cmdq-test {
		compatible = "mediatek,ktf-cmdq-test";
		mediatek,mailbox-gce = <0x2e>;
		mmsys_config = <0x24>;
		mboxes = <0x2e 0x8 0x0 0x1 0x2e 0x9 0xffffffff 0x1 0x2e 0xa 0x0 0x1>;
		gce-event-names = "disp_rdma0_sof", "disp_rdsz0_sof", "mdp_rdma0_sof";
		gce-events = <0x2e 0x9 0x2e 0x11 0x2e 0x0>;
		mediatek,gce-subsys = <0x63 0x1>;
		token_user0 = [02 89];
		token_gpr_set4 = [02 c0];
	};

	ap_ccif2@1023c000 {
		compatible = "mediatek,ap_ccif2";
		reg = <0x0 0x1023c000 0x0 0x1000>;
		interrupts = <0x0 0xa0 0x8>;
	};

	md_ccif2@1023d000 {
		compatible = "mediatek,md_ccif2";
		reg = <0x0 0x1023d000 0x0 0x1000>;
	};

	ap_ccif3@1023e000 {
		compatible = "mediatek,ap_ccif3";
		reg = <0x0 0x1023e000 0x0 0x1000>;
		interrupts = <0x0 0xa3 0x8>;
	};

	fingerprint {
		compatible = "mediatek,goodix-fp";
		phandle = <0xaa>;
	};

	accdet {
		compatible = "mediatek,pmic-accdet";
		phandle = <0xab>;
	};

	mt6358_gauge {
		compatible = "mediatek,mt6358_gauge";
		gauge_name = "gauge";
		alias_name = "MT6358";
	};

	gauge_timer {
		compatible = "mediatek,gauge_timer_service";
	};

	md_ccif3@1023f000 {
		compatible = "mediatek,md_ccif3";
		reg = <0x0 0x1023f000 0x0 0x1000>;
	};

	sspm@10440000 {
		compatible = "mediatek,sspm";
		reg = <0x0 0x10400000 0x0 0x28000 0x0 0x10440000 0x0 0x10000 0x0 0x10450000 0x0 0x100 0x0 0x10451000 0x0 0x8 0x0 0x10460000 0x0 0x100 0x0 0x10461000 0x0 0x8 0x0 0x10470000 0x0 0x100 0x0 0x10471000 0x0 0x8 0x0 0x10480000 0x0 0x100 0x0 0x10481000 0x0 0x8 0x0 0x10490000 0x0 0x100 0x0 0x10491000 0x0 0x8>;
		reg-names = "sspm_base", "cfgreg", "mbox0_base", "mbox0_ctrl", "mbox1_base", "mbox1_ctrl", "mbox2_base", "mbox2_ctrl", "mbox3_base", "mbox3_ctrl", "mbox4_base", "mbox4_ctrl";
		interrupts = <0x0 0xd7 0x4 0x0 0xda 0x4 0x0 0xdb 0x4 0x0 0xdc 0x4 0x0 0xdd 0x4 0x0 0xde 0x4>;
		interrupt-names = "ipc", "mbox0", "mbox1", "mbox2", "mbox3", "mbox4";
		sspm_mem_key = "mediatek,reserve-memory-sspm_share";
		sspm_mem_tbl = <0x0 0x100100 0x1 0x300 0x2 0xc00 0x3 0x1800 0x4 0x1000 0x5 0x1800 0x6 0x400000 0x7 0x9000 0x8 0x1000>;
	};

	gic500@0c000000 {
		compatible = "mediatek,gic500";
		reg = <0x0 0xc000000 0x0 0x400000>;
	};

	gic_cpu@0c400000 {
		compatible = "mediatek,gic_cpu";
		reg = <0x0 0xc400000 0x0 0x40000>;
	};

	lastbus@10001000 {
		compatible = "mediatek,lastbus-v1";
		reg = <0x0 0x10001000 0x0 0x1000 0x0 0x10003000 0x0 0x1000>;
	};

	dfd@10200b00 {
		compatible = "mediatek,dfd";
		reg = <0x0 0x10200b00 0x0 0x10000>;
		mediatek,enabled = <0x1>;
		mediatek,chain_length = <0xa7f8>;
		mediatek,rg_dfd_timeout = <0xa0>;
	};

	dfd_cache {
		compatible = "mediatek,dfd_cache";
		mediatek,enabled = <0x0>;
		mediatek,rg_dfd_timeout = <0x3e80>;
		phandle = <0xac>;
	};

	dbg_cti@0d020000 {
		compatible = "mediatek,dbg_cti";
		reg = <0x0 0xd020000 0x0 0x10000>;
	};

	dbg_etr@0d030000 {
		compatible = "mediatek,dbg_etr";
		reg = <0x0 0xd030000 0x0 0x10000>;
	};

	dbg_funnel@0d040000 {
		compatible = "mediatek,dbg_funnel";
		reg = <0x0 0xd040000 0x0 0x10000>;
	};

	dbg_dem@0d0a0000 {
		compatible = "mediatek,dbg_dem";
		reg = <0x0 0xd0a0000 0x0 0x10000>;
		interrupts = <0x0 0x9d 0x8>;
	};

	dbg_mdsys1@0d0c0000 {
		compatible = "mediatek,dbg_mdsys1";
		reg = <0x0 0xd0c0000 0x0 0x40000>;
	};

	dbg_apmcu_mp0@0d400000 {
		compatible = "mediatek,dbg_apmcu_mp0";
		reg = <0x0 0xd400000 0x0 0x1000>;
	};

	dbg_apmcu_mp0@0d410000 {
		compatible = "mediatek,dbg_apmcu_mp0";
		reg = <0x0 0xd410000 0x0 0x1000>;
	};

	dbg_apmcu_mp0@0d420000 {
		compatible = "mediatek,dbg_apmcu_mp0";
		reg = <0x0 0xd420000 0x0 0x1000>;
	};

	dbg_apmcu_mp0@0d430000 {
		compatible = "mediatek,dbg_apmcu_mp0";
		reg = <0x0 0xd430000 0x0 0x1000>;
	};

	dbg_apmcu_mp0@0d440000 {
		compatible = "mediatek,dbg_apmcu_mp0";
		reg = <0x0 0xd440000 0x0 0x1000>;
	};

	dbg_apmcu_mp0@0d510000 {
		compatible = "mediatek,dbg_apmcu_mp0";
		reg = <0x0 0xd510000 0x0 0x1000>;
	};

	dbg_apmcu_mp0@0d520000 {
		compatible = "mediatek,dbg_apmcu_mp0";
		reg = <0x0 0xd520000 0x0 0x1000>;
	};

	dbg_apmcu_mp0@0d530000 {
		compatible = "mediatek,dbg_apmcu_mp0";
		reg = <0x0 0xd530000 0x0 0x1000>;
	};

	dbg_apmcu_mp0@0d540000 {
		compatible = "mediatek,dbg_apmcu_mp0";
		reg = <0x0 0xd540000 0x0 0x1000>;
	};

	dbg_apmcu_mp0@0d610000 {
		compatible = "mediatek,dbg_apmcu_mp0";
		reg = <0x0 0xd610000 0x0 0x1000>;
	};

	dbg_apmcu_mp0@0d620000 {
		compatible = "mediatek,dbg_apmcu_mp0";
		reg = <0x0 0xd620000 0x0 0x1000>;
	};

	dbg_apmcu_mp0@0d630000 {
		compatible = "mediatek,dbg_apmcu_mp0";
		reg = <0x0 0xd630000 0x0 0x1000>;
	};

	dbg_apmcu_mp0@0d640000 {
		compatible = "mediatek,dbg_apmcu_mp0";
		reg = <0x0 0xd640000 0x0 0x1000>;
	};

	dbg_apmcu_mp0@0d710000 {
		compatible = "mediatek,dbg_apmcu_mp0";
		reg = <0x0 0xd710000 0x0 0x1000>;
	};

	dbg_apmcu_mp0@0d720000 {
		compatible = "mediatek,dbg_apmcu_mp0";
		reg = <0x0 0xd720000 0x0 0x1000>;
	};

	dbg_apmcu_mp0@0d730000 {
		compatible = "mediatek,dbg_apmcu_mp0";
		reg = <0x0 0xd730000 0x0 0x1000>;
	};

	dbg_apmcu_mp0@0d740000 {
		compatible = "mediatek,dbg_apmcu_mp0";
		reg = <0x0 0xd740000 0x0 0x1000>;
	};

	dbg_apmcu_mp1@0d800000 {
		compatible = "mediatek,dbg_apmcu_mp1";
		reg = <0x0 0xd800000 0x0 0x1000>;
	};

	dbg_apmcu_mp1@0d810000 {
		compatible = "mediatek,dbg_apmcu_mp1";
		reg = <0x0 0xd810000 0x0 0x1000>;
	};

	dbg_apmcu_mp1@0d820000 {
		compatible = "mediatek,dbg_apmcu_mp1";
		reg = <0x0 0xd820000 0x0 0x1000>;
	};

	dbg_apmcu_mp1@0d830000 {
		compatible = "mediatek,dbg_apmcu_mp1";
		reg = <0x0 0xd830000 0x0 0x1000>;
	};

	dbg_apmcu_mp1@0d840000 {
		compatible = "mediatek,dbg_apmcu_mp1";
		reg = <0x0 0xd840000 0x0 0x1000>;
	};

	dbg_apmcu_mp1@0d910000 {
		compatible = "mediatek,dbg_apmcu_mp1";
		reg = <0x0 0xd910000 0x0 0x1000>;
	};

	dbg_apmcu_mp1@0d920000 {
		compatible = "mediatek,dbg_apmcu_mp1";
		reg = <0x0 0xd920000 0x0 0x1000>;
	};

	dbg_apmcu_mp1@0d930000 {
		compatible = "mediatek,dbg_apmcu_mp1";
		reg = <0x0 0xd930000 0x0 0x1000>;
	};

	dbg_apmcu_mp1@0d940000 {
		compatible = "mediatek,dbg_apmcu_mp1";
		reg = <0x0 0xd940000 0x0 0x1000>;
	};

	dbg_apmcu_mp1@0da10000 {
		compatible = "mediatek,dbg_apmcu_mp1";
		reg = <0x0 0xda10000 0x0 0x1000>;
	};

	dbg_apmcu_mp1@0da20000 {
		compatible = "mediatek,dbg_apmcu_mp1";
		reg = <0x0 0xda20000 0x0 0x1000>;
	};

	dbg_apmcu_mp1@0da30000 {
		compatible = "mediatek,dbg_apmcu_mp1";
		reg = <0x0 0xda30000 0x0 0x1000>;
	};

	dbg_apmcu_mp1@0da40000 {
		compatible = "mediatek,dbg_apmcu_mp1";
		reg = <0x0 0xda40000 0x0 0x1000>;
	};

	dbg_apmcu_mp1@0db10000 {
		compatible = "mediatek,dbg_apmcu_mp1";
		reg = <0x0 0xdb10000 0x0 0x1000>;
	};

	dbg_apmcu_mp1@0db20000 {
		compatible = "mediatek,dbg_apmcu_mp1";
		reg = <0x0 0xdb20000 0x0 0x1000>;
	};

	dbg_apmcu_mp1@0db30000 {
		compatible = "mediatek,dbg_apmcu_mp1";
		reg = <0x0 0xdb30000 0x0 0x1000>;
	};

	dbg_apmcu_mp1@0db40000 {
		compatible = "mediatek,dbg_apmcu_mp1";
		reg = <0x0 0xdb40000 0x0 0x1000>;
	};

	infra_dbgsystop_cpu0@0e000000 {
		compatible = "mediatek,infra_dbgsystop_cpu0";
		reg = <0x0 0xe000000 0x0 0x100000>;
	};

	infra_dbgsystop_cpu1@0e100000 {
		compatible = "mediatek,infra_dbgsystop_cpu1";
		reg = <0x0 0xe100000 0x0 0x100000>;
	};

	infra_dbgsystop_cpu2@0e200000 {
		compatible = "mediatek,infra_dbgsystop_cpu2";
		reg = <0x0 0xe200000 0x0 0x100000>;
	};

	infra_dbgsystop_cpu3@0e300000 {
		compatible = "mediatek,infra_dbgsystop_cpu3";
		reg = <0x0 0xe300000 0x0 0x100000>;
	};

	infra_dbgsystop_cpu4@0e400000 {
		compatible = "mediatek,infra_dbgsystop_cpu4";
		reg = <0x0 0xe400000 0x0 0x100000>;
	};

	infra_dbgsystop_cpu5@0e500000 {
		compatible = "mediatek,infra_dbgsystop_cpu5";
		reg = <0x0 0xe500000 0x0 0x100000>;
	};

	infra_dbgsystop_cpu6@0e600000 {
		compatible = "mediatek,infra_dbgsystop_cpu6";
		reg = <0x0 0xe600000 0x0 0x100000>;
	};

	infra_dbgsystop_cpu7@0e700000 {
		compatible = "mediatek,infra_dbgsystop_cpu7";
		reg = <0x0 0xe700000 0x0 0x100000>;
	};

	ap_dma@11000000 {
		compatible = "mediatek,ap_dma";
		reg = <0x0 0x11000000 0x0 0x1000>;
		interrupts = <0x0 0x66 0x8>;
	};

	auxadc@11001000 {
		compatible = "mediatek,mt6768-auxadc";
		reg = <0x0 0x11001000 0x0 0x1000>;
		interrupts = <0x0 0x42 0x2>;
		clocks = <0x21 0x21>;
		clock-names = "main";
		#io-channel-cells = <0x1>;
		mediatek,cali-en-bit = <0x14>;
		mediatek,cali-ge-bit = <0xa>;
		mediatek,cali-oe-bit = <0x0>;
		mediatek,cali-efuse-index = <0x6a>;
		phandle = <0x23>;
	};

	dma-controller@11000980 {
		compatible = "mediatek,mt6577-uart-dma";
		reg = <0x0 0x11000980 0x0 0x80 0x0 0x11000a00 0x0 0x80 0x0 0x11000a80 0x0 0x80 0x0 0x11000b00 0x0 0x80>;
		interrupts = <0x0 0x66 0x8 0x0 0x67 0x8 0x0 0x68 0x8 0x0 0x72 0x8>;
		clocks = <0x21 0x26>;
		clock-names = "apdma";
		#dma-cells = <0x1>;
		dma-bits = <0x22>;
		phandle = <0x31>;
	};

	serial@11002000 {
		compatible = "mediatek,mt6577-uart";
		reg = <0x0 0x11002000 0x0 0x1000>;
		interrupts = <0x0 0x70 0x8>;
		clocks = <0x13 0x21 0x16>;
		clock-names = "baud", "bus";
		dmas = <0x31 0x0 0x31 0x1>;
		dma-names = "tx", "rx";
		phandle = <0xad>;
	};

	serial@11003000 {
		compatible = "mediatek,mt6577-uart";
		reg = <0x0 0x11003000 0x0 0x1000>;
		interrupts = <0x0 0x71 0x8>;
		clocks = <0x13 0x21 0x17>;
		clock-names = "baud", "bus";
		dmas = <0x31 0x2 0x31 0x3>;
		dma-names = "tx", "rx";
		phandle = <0xae>;
	};

	i2c_common {
		compatible = "mediatek,i2c_common";
		dma_support = [03];
		idvfs = [01];
		set_dt_div = [01];
		check_max_freq = [01];
		ver = [02];
		set_ltiming = [01];
		ext_time_config = [18 01];
		cnt_constraint = [01];
		control_irq_sel = [01];
		phandle = <0xaf>;
	};

	pwm@11006000 {
		compatible = "mediatek,pwm";
		reg = <0x0 0x11006000 0x0 0x1000>;
		interrupts = <0x0 0x62 0x8>;
		clocks = <0x21 0x10 0x21 0x11 0x21 0x12 0x21 0x13 0x21 0x14 0x21 0x30 0x21 0xf 0x21 0x15>;
		clock-names = "PWM1-main", "PWM2-main", "PWM3-main", "PWM4-main", "PWM5-main", "PWM6-main", "PWM-HCLK-main", "PWM-main";
	};

	i2c0@11007000 {
		compatible = "mediatek,i2c";
		id = <0x0>;
		reg = <0x0 0x11007000 0x0 0x1000 0x0 0x11000080 0x0 0x80>;
		interrupts = <0x0 0x69 0x8>;
		clocks = <0x21 0xb 0x21 0x26>;
		clock-names = "main", "dma";
		clock-div = <0x5>;
		scl-gpio-id = <0x53>;
		sda-gpio-id = <0x52>;
		gpio_start = <0x10002a00>;
		mem_len = <0x200>;
		eh_cfg = <0x30>;
		pu_cfg = <0x70>;
		rsel_cfg = <0x90>;
		aed = <0x1a>;
		phandle = <0xb0>;
	};

	i2c1@11008000 {
		compatible = "mediatek,i2c";
		id = <0x1>;
		reg = <0x0 0x11008000 0x0 0x1000 0x0 0x11000100 0x0 0x80>;
		interrupts = <0x0 0x6a 0x8>;
		clocks = <0x21 0xb 0x21 0x26>;
		clock-names = "main", "dma";
		clock-div = <0x5>;
		scl-gpio-id = <0x54>;
		sda-gpio-id = <0x51>;
		gpio_start = <0x10002a00>;
		mem_len = <0x200>;
		eh_cfg = <0x30>;
		pu_cfg = <0x70>;
		rsel_cfg = <0x90>;
		aed = <0x1a>;
		phandle = <0xb1>;
	};

	i2c2@11009000 {
		compatible = "mediatek,i2c";
		id = <0x2>;
		reg = <0x0 0x11009000 0x0 0x1000 0x0 0x11000180 0x0 0x180>;
		interrupts = <0x0 0x6b 0x8>;
		clocks = <0x21 0xb 0x21 0x26>;
		clock-names = "main", "dma";
		clock-div = <0x5>;
		scl-gpio-id = <0x67>;
		sda-gpio-id = <0x68>;
		gpio_start = <0x10002800>;
		mem_len = <0x200>;
		eh_cfg = <0x40>;
		pu_cfg = <0xa0>;
		rsel_cfg = <0xf0>;
		aed = <0x1a>;
		ch_offset_default = <0x100>;
		ch_offset_ccu = <0x200>;
		phandle = <0xb2>;
	};

	i2c3@1100f000 {
		compatible = "mediatek,i2c";
		id = <0x3>;
		reg = <0x0 0x1100f000 0x0 0x1000 0x0 0x11000300 0x0 0x100>;
		interrupts = <0x0 0x6c 0x8>;
		clocks = <0x21 0xb 0x21 0x26>;
		clock-names = "main", "dma";
		clock-div = <0x5>;
		scl-gpio-id = <0x32>;
		sda-gpio-id = <0x33>;
		gpio_start = <0x10002600>;
		mem_len = <0x200>;
		eh_cfg = <0x30>;
		pu_cfg = <0x60>;
		rsel_cfg = <0x90>;
		aed = <0x1a>;
		phandle = <0xb3>;
	};

	i2c4@11011000 {
		compatible = "mediatek,i2c";
		id = <0x4>;
		reg = <0x0 0x11011000 0x0 0x1000 0x0 0x11000400 0x0 0x180>;
		interrupts = <0x0 0x6d 0x8>;
		clocks = <0x21 0xb 0x21 0x26>;
		clock-names = "main", "dma";
		clock-div = <0x5>;
		scl-gpio-id = <0x69>;
		sda-gpio-id = <0x6a>;
		gpio_start = <0x10002800>;
		mem_len = <0x200>;
		eh_cfg = <0x40>;
		pu_cfg = <0xa0>;
		rsel_cfg = <0xf0>;
		aed = <0x1a>;
		ch_offset_default = <0x100>;
		ch_offset_ccu = <0x200>;
		phandle = <0xb4>;
	};

	i2c5@11016000 {
		compatible = "mediatek,i2c";
		id = <0x5>;
		reg = <0x0 0x11016000 0x0 0x1000 0x0 0x11000580 0x0 0x80>;
		interrupts = <0x0 0x93 0x8>;
		clocks = <0x21 0xb 0x21 0x26>;
		clock-names = "main", "dma";
		clock-div = <0x5>;
		scl-gpio-id = <0x30>;
		sda-gpio-id = <0x31>;
		gpio_start = <0x10002600>;
		mem_len = <0x200>;
		eh_cfg = <0x30>;
		pu_cfg = <0x60>;
		rsel_cfg = <0x90>;
		aed = <0x1a>;
		phandle = <0xb5>;
	};

	i2c6@1100d000 {
		compatible = "mediatek,i2c";
		id = <0x6>;
		reg = <0x0 0x1100d000 0x0 0x1000 0x0 0x11000600 0x0 0x80>;
		interrupts = <0x0 0x94 0x8>;
		clocks = <0x21 0xb 0x21 0x26>;
		clock-names = "main", "dma";
		clock-div = <0x5>;
		scl-gpio-id = <0x59>;
		sda-gpio-id = <0x5a>;
		gpio_start = <0x10002000>;
		mem_len = <0x200>;
		eh_cfg = <0x30>;
		pu_cfg = <0x60>;
		rsel_cfg = <0x90>;
		aed = <0x1a>;
		phandle = <0xb6>;
	};

	i2c7@11004000 {
		compatible = "mediatek,i2c";
		id = <0x7>;
		reg = <0x0 0x11004000 0x0 0x1000 0x0 0x11000680 0x0 0x180>;
		interrupts = <0x0 0x6e 0x8>;
		clocks = <0x21 0xb 0x21 0x26>;
		clock-names = "main", "dma";
		clock-div = <0x5>;
		scl-gpio-id = <0xaf>;
		sda-gpio-id = <0xb0>;
		gpio_start = <0x10002600>;
		mem_len = <0x200>;
		eh_cfg = <0x30>;
		pu_cfg = <0x60>;
		rsel_cfg = <0x90>;
		aed = <0x1a>;
		phandle = <0xb7>;

		speaker_amp@34 {
			compatible = "mediatek,speaker_amp";
			#sound-dai-cells = <0x0>;
			reg = <0x34>;
			status = "okay";
			phandle = <0x57>;
		};
	};

	i2c8@11005000 {
		compatible = "mediatek,i2c";
		id = <0x8>;
		reg = <0x0 0x11005000 0x0 0x1000 0x0 0x11000800 0x0 0x180>;
		interrupts = <0x0 0x6f 0x8>;
		clocks = <0x21 0xb 0x21 0x26>;
		clock-names = "main", "dma";
		clock-div = <0x5>;
		aed = <0x1a>;
		phandle = <0xb8>;
	};

	spi0@1100a000 {
		compatible = "mediatek,mt6765-spi";
		mediatek,pad-select = <0x0>;
		reg = <0x0 0x1100a000 0x0 0x1000>;
		interrupts = <0x0 0x8a 0x8>;
		clocks = <0x12 0xb 0x12 0x5b 0x21 0x1b>;
		clock-names = "parent-clk", "sel-clk", "spi-clk";
		phandle = <0xb9>;
	};

	eem_fsm@1100b000 {
		compatible = "mediatek,eem_fsm";
		reg = <0x0 0x1100b000 0x0 0x1000>;
		interrupts = <0x0 0x8e 0x8>;
		eem-status = <0x1>;
		eem-initmon-little = <0xf>;
		eem-initmon-big = <0xf>;
		eem-initmon-cci = <0xf>;
		eem-initmon-gpu = <0xf>;
		eem-clamp-little = <0x0>;
		eem-clamp-big = <0x0>;
		eem-clamp-cci = <0x0>;
		eem-clamp-gpu = <0x0>;
		eem-offset-little = <0xff>;
		eem-offset-big = <0xff>;
		eem-offset-cci = <0xff>;
		eem-offset-gpu = <0xff>;
		phandle = <0xba>;
	};

	therm_ctrl@1100b000 {
		compatible = "mediatek,therm_ctrl";
		reg = <0x0 0x1100b000 0x0 0x1000>;
		interrupts = <0x0 0x63 0x8>;
		clocks = <0x21 0xa>;
		clock-names = "therm-main";
	};

	thermal-sensor1 {
		compatible = "mediatek,mtboard-thermistor1";
		io-channels = <0x23 0x0>;
		io-channel-names = "thermistor-ch0";
		phandle = <0xbb>;
	};

	thermal-sensor2 {
		compatible = "mediatek,mtboard-thermistor2";
		io-channels = <0x23 0x1>;
		io-channel-names = "thermistor-ch1";
		phandle = <0xbc>;
	};

	drcc {
		compatible = "mediatek,drcc";
		state = <0xff>;
		drcc0_Vref = <0xff>;
		drcc1_Vref = <0xff>;
		drcc2_Vref = <0xff>;
		drcc3_Vref = <0xff>;
		drcc4_Vref = <0xff>;
		drcc5_Vref = <0xff>;
		drcc6_Vref = <0xff>;
		drcc7_Vref = <0xff>;
		drcc0_Hwgatepct = <0xff>;
		drcc1_Hwgatepct = <0xff>;
		drcc2_Hwgatepct = <0xff>;
		drcc3_Hwgatepct = <0xff>;
		drcc4_Hwgatepct = <0xff>;
		drcc5_Hwgatepct = <0xff>;
		drcc6_Hwgatepct = <0xff>;
		drcc7_Hwgatepct = <0xff>;
		drcc0_Code = <0xff>;
		drcc1_Code = <0xff>;
		drcc2_Code = <0xff>;
		drcc3_Code = <0xff>;
		drcc4_Code = <0xff>;
		drcc5_Code = <0xff>;
		drcc6_Code = <0xff>;
		drcc7_Code = <0xff>;
		phandle = <0xbd>;
	};

	btif@1100c000 {
		compatible = "mediatek,btif";
		reg = <0x0 0x1100c000 0x0 0x1000 0x0 0x11000b80 0x0 0x80 0x0 0x11000c00 0x0 0x80>;
		interrupts = <0x0 0x85 0x8 0x0 0x73 0x8 0x0 0x8d 0x8>;
		clocks = <0x21 0x1a 0x21 0x26>;
		clock-names = "btifc", "apdmac";
	};

	consys@18002000 {
		compatible = "mediatek,mt6768-consys";
		#address-cells = <0x2>;
		#size-cells = <0x2>;
		reg = <0x0 0x18002000 0x0 0x1000 0x0 0x10007000 0x0 0x100 0x0 0x10001000 0x0 0x1000 0x0 0x10006000 0x0 0x1000 0x0 0x18007000 0x0 0x1000 0x0 0x180b1000 0x0 0x1000 0x0 0x180a3000 0x0 0x1000 0x0 0x180a5000 0x0 0x800 0x0 0x180c1000 0x0 0x1000 0x0 0x18004000 0x0 0x1000>;
		interrupts = <0x0 0x11c 0x8 0x0 0x4e 0x8 0x0 0x11f 0x1>;
		clocks = <0x22 0x1>;
		clock-names = "conn";
		wifi_ant_swap_gpio = <0x1e 0x6c 0x0>;
		phandle = <0xbe>;
	};

	disp_pwm@1100e000 {
		compatible = "mediatek,disp_pwm";
		reg = <0x0 0x1100e000 0x0 0x1000>;
	};

	spi1@11010000 {
		compatible = "mediatek,mt6765-spi";
		mediatek,pad-select = <0x0>;
		reg = <0x0 0x11010000 0x0 0x1000>;
		interrupts = <0x0 0x8b 0x8>;
		clocks = <0x12 0xb 0x12 0x5b 0x21 0x34>;
		clock-names = "parent-clk", "sel-clk", "spi-clk";
		phandle = <0xbf>;
	};

	spi2@11012000 {
		compatible = "mediatek,mt6765-spi";
		mediatek,pad-select = <0x0>;
		reg = <0x0 0x11012000 0x0 0x1000>;
		interrupts = <0x0 0x91 0x8>;
		clocks = <0x12 0xb 0x12 0x5b 0x21 0x37>;
		clock-names = "parent-clk", "sel-clk", "spi-clk";
		phandle = <0xc0>;
	};

	spi3@11013000 {
		compatible = "mediatek,mt6765-spi";
		mediatek,pad-select = <0x0>;
		reg = <0x0 0x11013000 0x0 0x1000>;
		interrupts = <0x0 0x92 0x8>;
		clocks = <0x12 0xb 0x12 0x5b 0x21 0x38>;
		clock-names = "parent-clk", "sel-clk", "spi-clk";
		phandle = <0xc1>;
	};

	spi4@11014000 {
		compatible = "mediatek,mt6765-spi";
		mediatek,pad-select = <0x0>;
		reg = <0x0 0x11014000 0x0 0x1000>;
		interrupts = <0x0 0x74 0x8>;
		clocks = <0x12 0xb 0x12 0x5b 0x21 0x41>;
		clock-names = "parent-clk", "sel-clk", "spi-clk";
		phandle = <0xc2>;
	};

	spi5@11015000 {
		compatible = "mediatek,mt6765-spi";
		mediatek,pad-select = <0x0>;
		reg = <0x0 0x11015000 0x0 0x1000>;
		interrupts = <0x0 0x75 0x8>;
		clocks = <0x12 0xb 0x12 0x5b 0x21 0x42>;
		clock-names = "parent-clk", "sel-clk", "spi-clk";
		phandle = <0xc3>;
	};

	imp_iic@11017000 {
		compatible = "mediatek,imp_iic";
		reg = <0x0 0x11017000 0x0 0x1000>;
	};

	nfi@11018000 {
		compatible = "mediatek,nfi";
		reg = <0x0 0x11018000 0x0 0x1000>;
	};

	nfiecc@11019000 {
		compatible = "mediatek,nfiecc";
		reg = <0x0 0x11019000 0x0 0x1000>;
	};

	usb0@11200000 {
		compatible = "mediatek,mt6768-usb20";
		reg = <0x0 0x11200000 0x0 0x10000 0x0 0x11cc0000 0x0 0x10000>;
		interrupts = <0x0 0x61 0x8>;
		mode = <0x2>;
		multipoint = <0x1>;
		num_eps = <0x10>;
		clocks = <0x21 0x8 0x12 0x66 0x12 0x20>;
		clock-names = "usb0", "usb0_clk_top_sel", "usb0_clk_univpll3_d4";
		pericfg = <0x32>;
	};

	usb_tuning {
		compatible = "mediatek,phy_tuning";
		phandle = <0xc4>;

		tune@1 {
			label = "bgr_en";
			offset = <0x0>;
			shift = <0x0>;
			mask = <0x1>;
			value = <0x0>;
		};

		tune@2 {
			label = "intr_en";
			offset = <0x0>;
			shift = <0x5>;
			mask = <0x1>;
			value = <0x1>;
		};

		tune@3 {
			label = "mpx_out_sel";
			offset = <0x0>;
			shift = <0x1c>;
			mask = <0x3>;
			value = <0x0>;
		};

		tune@4 {
			label = "term_vref_sel";
			offset = <0x4>;
			shift = <0x8>;
			mask = <0x7>;
			value = <0x6>;
		};

		tune@5 {
			label = "vrt_ref";
			offset = <0x4>;
			shift = <0xc>;
			mask = <0x7>;
			value = <0x7>;
		};

		tune@6 {
			label = "intr_cal";
			offset = <0x4>;
			shift = <0x13>;
			mask = <0x1f>;
			value = <0x19>;
		};

		tune@7 {
			label = "hstx_srctrl";
			offset = <0x14>;
			shift = <0xc>;
			mask = <0x7>;
			value = <0x1>;
		};

		tune@8 {
			label = "hstx_srcal_en";
			offset = <0x14>;
			shift = <0xf>;
			mask = <0x1>;
			value = <0x0>;
		};

		tune@9 {
			label = "sqth";
			offset = <0x18>;
			shift = <0x0>;
			mask = <0xf>;
			value = <0x1>;
		};

		tune@10 {
			label = "discth";
			offset = <0x18>;
			shift = <0x4>;
			mask = <0xf>;
			value = <0xa>;
		};

		tune@11 {
			label = "enhance";
			offset = <0x18>;
			shift = <0x1e>;
			mask = <0x3>;
			value = <0x3>;
		};
	};

	msdc@11230000 {
		compatible = "mediatek,msdc";
		reg = <0x0 0x11230000 0x0 0x10000>;
		interrupts = <0x0 0x64 0x8>;
		index = [00];
		clk_src = [01];
		bus-width = <0x8>;
		max-frequency = <0xbebc200>;
		cap-mmc-highspeed;
		mmc-ddr-1_8v;
		mmc-hs200-1_8v;
		mmc-hs400-1_8v;
		no-sd;
		no-sdio;
		non-removable;
		pinctl = <0x33>;
		pinctl_hs400 = <0x34>;
		pinctl_hs200 = <0x35>;
		register_setting = <0x36>;
		host_function = [00];
		bootable;
		req_vcore = <0x1>;
		status = "okay";
		vmmc-supply = <0x37>;
		clocks = <0x21 0x4c 0x21 0x1c 0x21 0x44>;
		clock-names = "msdc0-clock", "msdc0-hclock", "msdc0-aes-clock";
		phandle = <0xc5>;
	};

	msdc@11240000 {
		compatible = "mediatek,msdc";
		reg = <0x0 0x11240000 0x0 0x10000>;
		interrupts = <0x0 0x65 0x8>;
		index = [01];
		clk_src = [02];
		bus-width = <0x4>;
		max-frequency = <0xbebc200>;
		cap-sd-highspeed;
		sd-uhs-sdr12;
		sd-uhs-sdr25;
		sd-uhs-sdr50;
		sd-uhs-sdr104;
		sd-uhs-ddr50;
		no-mmc;
		no-sdio;
		pinctl = <0x38>;
		pinctl_sdr104 = <0x39>;
		pinctl_sdr50 = <0x3a>;
		pinctl_ddr50 = <0x3b>;
		register_setting = <0x3c>;
		host_function = [01];
		cd_level = [00];
		cd-gpios = <0x1e 0x12 0x0>;
		status = "okay";
		vmmc-supply = <0x3d>;
		vqmmc-supply = <0x3e>;
		clocks = <0x21 0x4d 0x21 0x1d>;
		clock-names = "msdc1-clock", "msdc1-hclock";
		phandle = <0xc6>;
	};

	msdc0_top@11cd0000 {
		compatible = "mediatek,msdc0_top";
		reg = <0x0 0x11cd0000 0x0 0x1000>;
	};

	msdc1_top@11c90000 {
		compatible = "mediatek,msdc1_top";
		reg = <0x0 0x11c90000 0x0 0x1000>;
	};

	usb1p_sif@11210000 {
		compatible = "mediatek,usb1p_sif";
		reg = <0x0 0x11210000 0x0 0x10000>;
	};

	audio@11220000 {
		compatible = "mediatek,audio", "syscon";
		reg = <0x0 0x11220000 0x0 0x1000>;
		#clock-cells = <0x1>;
		phandle = <0x40>;
	};

	mt6768-afe-pcm@11220000 {
		compatible = "mediatek,mt6768-sound";
		reg = <0x0 0x11220000 0x0 0x1000>;
		interrupts = <0x0 0xa9 0x8>;
		topckgen = <0x12>;
		apmixed = <0x3f>;
		clocks = <0x40 0x0 0x40 0x5 0x40 0x6 0x40 0x4 0x40 0x1 0x40 0x2 0x40 0x3 0x40 0x7 0x21 0x2b 0x21 0x33 0x12 0x5f 0x12 0x60 0x12 0x3 0x12 0x61 0x12 0x29 0x12 0x62 0x12 0x2c 0x12 0x82 0x12 0x83 0x12 0x84 0x12 0x85 0x12 0x70 0x12 0x71 0x12 0x72 0x12 0x73 0x3f 0x8 0x13>;
		clock-names = "aud_afe_clk", "aud_dac_clk", "aud_dac_predis_clk", "aud_adc_clk", "aud_apll22m_clk", "aud_apll24m_clk", "aud_apll1_tuner_clk", "aud_tml_clk", "aud_infra_axi_clk", "aud_infra_26m_clk", "top_mux_audio", "top_mux_audio_int", "top_sys_pll1_d4", "top_mux_aud_1", "top_apll1_ck", "top_mux_aud_eng1", "top_apll1_d8", "top_i2s0_m_sel", "top_i2s1_m_sel", "top_i2s2_m_sel", "top_i2s3_m_sel", "top_apll12_div0", "top_apll12_div1", "top_apll12_div2", "top_apll12_div3", "apmixed_apll1", "top_clk26m_clk";
		pinctrl-names = "aud_clk_mosi_off", "aud_clk_mosi_on", "aud_clk_miso_off", "aud_clk_miso_on", "aud_dat_mosi_off", "aud_dat_mosi_on", "aud_dat_miso_off", "aud_dat_miso_on", "aud_gpio_i2s0_off", "aud_gpio_i2s0_on", "aud_gpio_i2s1_off", "aud_gpio_i2s1_on", "aud_gpio_i2s2_off", "aud_gpio_i2s2_on", "aud_gpio_i2s3_off", "aud_gpio_i2s3_on", "vow_dat_miso_off", "vow_dat_miso_on", "vow_clk_miso_off", "vow_clk_miso_on";
		pinctrl-0 = <0x41>;
		pinctrl-1 = <0x42>;
		pinctrl-2 = <0x43>;
		pinctrl-3 = <0x44>;
		pinctrl-4 = <0x45>;
		pinctrl-5 = <0x46>;
		pinctrl-6 = <0x47>;
		pinctrl-7 = <0x48>;
		pinctrl-8 = <0x49>;
		pinctrl-9 = <0x4a>;
		pinctrl-10 = <0x4b>;
		pinctrl-11 = <0x4c>;
		pinctrl-12 = <0x4d>;
		pinctrl-13 = <0x4e>;
		pinctrl-14 = <0x4f>;
		pinctrl-15 = <0x50>;
		pinctrl-16 = <0x51>;
		pinctrl-17 = <0x52>;
		pinctrl-18 = <0x53>;
		pinctrl-19 = <0x54>;
		phandle = <0x56>;
	};

	mt6358_snd {
		compatible = "mediatek,mt6358-sound";
		mediatek,pwrap-regmap = <0x20>;
		phandle = <0x55>;
	};

	sound {
		compatible = "mediatek,mt6768-mt6358-sound";
		mediatek,audio-codec = <0x55>;
		mediatek,platform = <0x56>;
		mtk_spk_i2s_out = <0x3>;
		mtk_spk_i2s_in = <0x0>;
		phandle = <0xc7>;

		mediatek,speaker-codec {
			sound-dai = <0x57>;
		};
	};

	snd_scp_spk {
		compatible = "mediatek,snd_scp_spk";
		phandle = <0xc8>;
	};

	audio_sram@11221000 {
		compatible = "mediatek,audio_sram";
		reg = <0x0 0x11221000 0x0 0x9000>;
		prefer_mode = <0x1>;
		mode_size = <0x6c00 0x9000>;
		block_size = <0x1000>;
	};

	mtk-btcvsd-snd@18050000 {
		compatible = "mediatek,mtk-btcvsd-snd";
		reg = <0x0 0x18050000 0x0 0x1000 0x0 0x18080000 0x0 0x10000>;
		interrupts = <0x0 0x11b 0x8>;
		mediatek,infracfg = <0x21>;
		mediatek,offset = <0xf00 0x800 0x140 0x144 0x148>;
		disable_write_silence = <0x0>;
	};

	mt_soc_playback_offload {
		compatible = "mediatek,mt_soc_offload_common";
	};

	mipi_rx_ana_csi0a@11c10000 {
		compatible = "mediatek,mipi_rx_ana_csi0a", "syscon";
		reg = <0x0 0x11c10000 0x0 0x1000>;
		#clock-cells = <0x1>;
		phandle = <0x62>;
	};

	mipi_rx_ana_csi0b@11c11000 {
		compatible = "mediatek,mipi_rx_ana_csi0b", "syscon";
		reg = <0x0 0x11c11000 0x0 0x1000>;
		#clock-cells = <0x1>;
		phandle = <0x63>;
	};

	mipi_rx_ana_csi1a@11c12000 {
		compatible = "mediatek,mipi_rx_ana_csi1a", "syscon";
		reg = <0x0 0x11c12000 0x0 0x1000>;
		#clock-cells = <0x1>;
		phandle = <0x64>;
	};

	mipi_rx_ana_csi1b@11c13000 {
		compatible = "mediatek,mipi_rx_ana_csi1b", "syscon";
		reg = <0x0 0x11c13000 0x0 0x1000>;
		#clock-cells = <0x1>;
		phandle = <0x65>;
	};

	mipi_rx_ana_csi2a@11c14000 {
		compatible = "mediatek,mipi_rx_ana_csi2a", "syscon";
		reg = <0x0 0x11c14000 0x0 0x1000>;
		#clock-cells = <0x1>;
		phandle = <0x66>;
	};

	mipi_rx_ana_csi2b@11c15000 {
		compatible = "mediatek,mipi_rx_ana_csi2b", "syscon";
		reg = <0x0 0x11c15000 0x0 0x1000>;
		#clock-cells = <0x1>;
		phandle = <0x67>;
	};

	mipi_tx0@11c80000 {
		compatible = "mediatek,mipi_tx0";
		reg = <0x0 0x11c80000 0x0 0x10000>;
	};

	efusec@11ce0000 {
		compatible = "mediatek,efusec";
		reg = <0x0 0x11ce0000 0x0 0x10000>;
	};

	mfg_cfg@13000000 {
		compatible = "mediatek,mfgcfg", "syscon";
		reg = <0x0 0x13000000 0x0 0x1000>;
		#clock-cells = <0x1>;
		phandle = <0x58>;
	};

	mali@13040000 {
		compatible = "mediatek,mali", "arm,mali-midgard", "arm,mali-bifrost";
		reg = <0x0 0x13040000 0x0 0x4000>;
		interrupts = <0x0 0x112 0x8 0x0 0x113 0x8 0x0 0x114 0x8 0x0 0x115 0x8 0x0 0x116 0x8>;
		interrupt-names = "GPU", "MMU", "JOB", "EVENT", "PWR";
	};

	gpufreq {
		compatible = "mediatek,mt6768-gpufreq";
		clocks = <0x12 0x54 0x12 0x26 0x12 0x6 0x58 0x0 0x22 0x9 0x22 0x4 0x22 0x7 0x22 0x8>;
		clock-names = "clk_mux", "clk_main_parent", "clk_sub_parent", "subsys_mfg_cg", "mtcmos_mfg_async", "mtcmos_mfg", "mtcmos_mfg_core0", "mtcmos_mfg_core1";
	};

	mmsys_config@14000000 {
		compatible = "mediatek,mmsys_config", "syscon";
		reg = <0x0 0x14000000 0x0 0x1000>;
		interrupts = <0x0 0xf0 0x8>;
		#clock-cells = <0x1>;
		clocks = <0x24 0x17 0x24 0x1c 0x24 0x1d>;
		clock-names = "CAM_MDP", "IMG_DL_RELAY", "IMG_DL_ASYNC_TOP";
		phandle = <0x24>;
	};

	disp_mutex0@14001000 {
		compatible = "mediatek,disp_mutex0";
		reg = <0x0 0x14001000 0x0 0x1000>;
		interrupts = <0x0 0xdf 0x8>;
		phandle = <0x2d>;
	};

	smi_common@14002000 {
		compatible = "mediatek,smi_common";
		reg = <0x0 0x14002000 0x0 0x1000>;
		mediatek,smi-id = <0x5>;
		clocks = <0x22 0x3 0x24 0x15 0x24 0x16 0x24 0x13>;
		clock-names = "scp-dis", "mm-comm0", "mm-comm1", "mm-common";
		mmsys_config = <0x24>;
	};

	mmdvfs_pmqos {
		compatible = "mediatek,mmdvfs_pmqos";
		mm_step0 = <0x1c9 0x1 0x0 0x3>;
		mm_step1 = <0x138 0x1 0x0 0x4>;
		mm_step2 = <0xe4 0x1 0x0 0x5>;
		venc_step0 = <0x1c9 0x1 0x1 0x3>;
		venc_step1 = <0x1a0 0x1 0x1 0x6>;
		venc_step2 = <0x138 0x1 0x1 0x4>;
		cam_step0 = <0x222 0x1 0x2 0x7>;
		cam_step1 = <0x138 0x1 0x2 0x4>;
		cam_step2 = <0xe4 0x1 0x2 0x5>;
		vopp_steps = <0x0 0x1 0x3>;
		disp_freq = "mm_step0", "mm_step1", "mm_step2";
		mdp_freq = "mm_step0", "mm_step1", "mm_step2";
		cam_freq = "cam_step0", "cam_step1", "cam_step2";
		img_freq = "mm_step0", "mm_step1", "mm_step2";
		vdec_freq = "mm_step0", "mm_step1", "mm_step2";
		venc_freq = "venc_step0", "venc_step1", "venc_step2";
		clocks = <0x12 0x52 0x12 0x6e 0x12 0x6f 0x12 0x21 0x12 0x17 0x12 0x22 0x12 0x19 0x12 0x1>;
		clock-names = "mmdvfs_clk_mm_sel_ck", "mmdvfs_clk_venc_sel_ck", "mmdvfs_clk_cam_sel_ck", "mmdvfs_clk_mmpll_ck", "mmdvfs_clk_univpll1_d2_ck", "mmdvfs_clk_mmpll_d2_ck", "mmdvfs_clk_univpll_d3_ck", "mmdvfs_clk_syspll_d2_ck";
	};

	smi_larb0@14003000 {
		compatible = "mediatek,smi_larb0", "mediatek,smi_larb";
		reg = <0x0 0x14003000 0x0 0x1000>;
		mediatek,smi-id = <0x0>;
		clocks = <0x22 0x3 0x24 0x14>;
		clock-names = "scp-dis", "mm-larb0";
		phandle = <0x59>;
	};

	mdp_rdma0@14004000 {
		compatible = "mediatek,mdp_rdma0";
		reg = <0x0 0x14004000 0x0 0x1000>;
		interrupts = <0x0 0xe0 0x8>;
		clocks = <0x24 0x0>;
		clock-names = "MDP_RDMA0";
		phandle = <0x25>;
	};

	mdp_ccorr0@14005000 {
		compatible = "mediatek,mdp_ccorr0";
		reg = <0x0 0x14005000 0x0 0x1000>;
		interrupts = <0x0 0xef 0x8>;
		clocks = <0x24 0x1>;
		clock-names = "MDP_CCORR";
		phandle = <0x2c>;
	};

	mdp_rsz0@14006000 {
		compatible = "mediatek,mdp_rsz0";
		reg = <0x0 0x14006000 0x0 0x1000>;
		interrupts = <0x0 0xe1 0x8>;
		clocks = <0x24 0x2>;
		clock-names = "MDP_RSZ0";
		phandle = <0x26>;
	};

	mdp_rsz1@14007000 {
		compatible = "mediatek,mdp_rsz1";
		reg = <0x0 0x14007000 0x0 0x1000>;
		interrupts = <0x0 0xe2 0x8>;
		clocks = <0x24 0x3>;
		clock-names = "MDP_RSZ1";
		phandle = <0x27>;
	};

	mdp_wdma0@14008000 {
		compatible = "mediatek,mdp_wdma0";
		reg = <0x0 0x14008000 0x0 0x1000>;
		interrupts = <0x0 0xe5 0x8>;
		clocks = <0x24 0x6>;
		clock-names = "MDP_WDMA";
		phandle = <0x28>;
	};

	mdp_wrot0@14009000 {
		compatible = "mediatek,mdp_wrot0";
		reg = <0x0 0x14009000 0x0 0x1000>;
		interrupts = <0x0 0xe4 0x8>;
		clocks = <0x24 0x5>;
		clock-names = "MDP_WROT0";
		phandle = <0x29>;
	};

	mdp_tdshp0@1400a000 {
		compatible = "mediatek,mdp_tdshp0";
		reg = <0x0 0x1400a000 0x0 0x1000>;
		clocks = <0x24 0x4>;
		clock-names = "MDP_TDSHP";
		phandle = <0x2a>;
	};

	disp_ovl0@1400b000 {
		compatible = "mediatek,disp_ovl0";
		reg = <0x0 0x1400b000 0x0 0x1000>;
		interrupts = <0x0 0xe6 0x8>;
	};

	disp_rdma0@1400d000 {
		compatible = "mediatek,disp_rdma0";
		reg = <0x0 0x1400d000 0x0 0x1000>;
		interrupts = <0x0 0xe7 0x8>;
	};

	disp_wdma0@1400e000 {
		compatible = "mediatek,disp_wdma0";
		reg = <0x0 0x1400e000 0x0 0x1000>;
		interrupts = <0x0 0xe8 0x8>;
	};

	disp_color0@1400f000 {
		compatible = "mediatek,disp_color0";
		reg = <0x0 0x1400f000 0x0 0x1000>;
		interrupts = <0x0 0xe9 0x8>;
		clocks = <0x24 0xc>;
		clock-names = "MDP_COLOR";
		phandle = <0x2b>;
	};

	disp_ccorr0@14010000 {
		compatible = "mediatek,disp_ccorr0";
		reg = <0x0 0x14010000 0x0 0x1000>;
		interrupts = <0x0 0xea 0x8>;
	};

	disp_aal0@14011000 {
		compatible = "mediatek,disp_aal0";
		reg = <0x0 0x14011000 0x0 0x1000>;
		interrupts = <0x0 0xeb 0x8>;
	};

	disp_gamma0@14012000 {
		compatible = "mediatek,disp_gamma0";
		reg = <0x0 0x14012000 0x0 0x1000>;
		interrupts = <0x0 0xec 0x8>;
	};

	disp_dither0@14013000 {
		compatible = "mediatek,disp_dither0";
		reg = <0x0 0x14013000 0x0 0x1000>;
		interrupts = <0x0 0xed 0x8>;
	};

	dsi0@14014000 {
		compatible = "mediatek,dsi0";
		reg = <0x0 0x14014000 0x0 0x1000>;
		interrupts = <0x0 0xee 0x8>;
	};

	disp_ovl0_2l@1400c000 {
		compatible = "mediatek,disp_ovl0_2l";
		reg = <0x0 0x1400c000 0x0 0x1000>;
		interrupts = <0x0 0xf2 0x8>;
	};

	disp_rsz0@14015000 {
		compatible = "mediatek,disp_rsz0";
		reg = <0x0 0x14015000 0x0 0x1000>;
		interrupts = <0x0 0x125 0x8>;
	};

	mtkfb@0 {
		compatible = "mediatek,mtkfb";
		phandle = <0xc9>;
	};

	dispsys {
		compatible = "mediatek,dispsys";
		mediatek,larb = <0x59>;
		clocks = <0x22 0x3 0x24 0x13 0x24 0x14 0x24 0x15 0x24 0x16 0x24 0x7 0x24 0x8 0x24 0xa 0x24 0xb 0x24 0xc 0x24 0xd 0x24 0xe 0x24 0xf 0x24 0x10 0x24 0x11 0x24 0x1e 0x24 0x1c 0x24 0x1f 0x24 0x9 0x3f 0x15 0x12 0x63 0x21 0x31 0x13 0x12 0x1b 0x12 0x2e 0x12 0x30>;
		clock-names = "MMSYS_MTCMOS", "MMSYS_SMI_COMMON", "MMSYS_SMI_LARB0", "MMSYS_GALS_COMM0", "MMSYS_GALS_COMM1", "MMSYS_DISP_OVL0", "MMSYS_DISP_OVL0_2L", "MMSYS_DISP_RDMA0", "MMSYS_DISP_WDMA0", "MMSYS_DISP_COLOR0", "MMSYS_DISP_CCORR0", "MMSYS_DISP_AAL0", "MMSYS_DISP_GAMMA0", "MMSYS_DISP_DITHER0", "MMSYS_DSI0_MM_CK", "MMSYS_DSI0_IF_CK", "MMSYS_IMG_DL_RELAY", "MMSYS_26M", "MMSYS_DISP_RSZ0", "APMIXED_MIPI_26M", "TOP_MUX_DISP_PWM", "DISP_PWM", "TOP_26M", "TOP_UNIVPLL2_D4", "TOP_ULPOSC1_D2", "TOP_ULPOSC1_D8";
	};

	dsi_te {
		compatible = "mediatek, dsi_te-eint";
		status = "disabled";
		phandle = <0xca>;
	};

	mm_mutex@14016000 {
		compatible = "mediatek,mm_mutex";
		reg = <0x0 0x14016000 0x0 0x1000>;
	};

	imgsys@15020000 {
		compatible = "mediatek,imgsys", "syscon";
		reg = <0x0 0x15020000 0x0 0x1000>;
		#clock-cells = <0x1>;
		clocks = <0x22 0x3 0x22 0x5 0x22 0xa 0x5a 0x1 0x5b 0x2 0x5b 0x3 0x5b 0x4 0x5b 0x5 0x5b 0x6 0x5b 0x7>;
		clock-names = "ISP_SCP_SYS_DIS", "ISP_SCP_SYS_ISP", "ISP_SCP_SYS_CAM", "ISP_CLK_IMG_DIP", "ISP_CLK_CAM", "ISP_CLK_CAMTG", "ISP_CLK_CAM_SENINF", "ISP_CLK_CAMSV0", "ISP_CLK_CAMSV1", "ISP_CLK_CAMSV2";
		phandle = <0x5a>;
	};

	dip1@15022000 {
		compatible = "mediatek,dip1";
		reg = <0x0 0x15022000 0x0 0x3000>;
		interrupts = <0x0 0x10e 0x8>;
	};

	fdvt@1502b000 {
		compatible = "mediatek,fdvt";
		reg = <0x0 0x1502b000 0x0 0x1000>;
		interrupts = <0x0 0x111 0x8>;
		clocks = <0x5a 0x2>;
		clock-names = "FD_CLK_IMG_FDVT";
	};

	dpe@15028000 {
		compatible = "mediatek,dpe";
		reg = <0x0 0x15028000 0x0 0x1000>;
		interrupts = <0x0 0x10f 0x8>;
		clocks = <0x5a 0x3>;
		clock-names = "DPE_CG_IMG_DPE";
	};

	smi_larb2@15021000 {
		compatible = "mediatek,smi_larb2", "mediatek,smi_larb";
		reg = <0x0 0x15021000 0x0 0x1000>;
		mediatek,smi-id = <0x2>;
		clocks = <0x22 0x5 0x24 0x18 0x5a 0x0>;
		clock-names = "scp-isp", "mm-img", "img-larb2";
		phandle = <0xcb>;
	};

	vcu@16000000 {
		compatible = "mediatek-vcu";
		mediatek,vcuid = <0x0>;
		mediatek,vcuname = "vcu";
		reg = <0x0 0x16000000 0x0 0x40000 0x0 0x17020000 0x0 0x10000 0x0 0x19002000 0x0 0x1000>;
		mediatek,mailbox-gce = <0x2e>;
		mboxes = <0x2e 0x1 0x0 0x1 0x2e 0x5 0x0 0x1>;
		gce-event-names = "venc_eof", "venc_cmdq_pause_done", "venc_mb_done", "venc_128B_cnt_done";
		gce-events = <0x2e 0x121 0x2e 0x122 0x2e 0x124 0x2e 0x125>;
		phandle = <0x5d>;
	};

	vdec_gcon@16000000 {
		compatible = "mediatek,vdec_gcon", "syscon";
		reg = <0x0 0x16000000 0x0 0x1000 0x0 0x16020000 0x0 0x400 0x0 0x16025000 0x0 0x1000>;
		mediatek,larb = <0x5c>;
		interrupts = <0x0 0xf6 0x8>;
		mediatek,vcu = <0x5d>;
		clocks = <0x22 0x3 0x22 0xc 0x5e 0x0>;
		clock-names = "MT_SCP_SYS_DIS", "MT_SCP_SYS_VDE", "MT_CG_VDEC";
		#clock-cells = <0x1>;
		phandle = <0x5e>;
	};

	smi_larb1@16010000 {
		compatible = "mediatek,smi_larb1", "mediatek,smi_larb";
		reg = <0x0 0x16010000 0x0 0x1000>;
		interrupts = <0x0 0xf7 0x8>;
		mediatek,smi-id = <0x1>;
		clocks = <0x22 0xc 0x24 0x1b 0x5e 0x3>;
		clock-names = "scp-vdec", "mm-vdec", "vdec-larb1";
		phandle = <0x5c>;
	};

	vdec@16020000 {
		compatible = "mediatek,vdec";
		reg = <0x0 0x16020000 0x0 0x10000>;
		interrupts = <0x0 0xf6 0x8>;
	};

	reserve@16030000 {
		compatible = "mediatek,reserve";
		reg = <0x0 0x16030000 0x0 0x10000>;
	};

	vdec_mbist_ctrl@16001000 {
		compatible = "mediatek,vdec_mbist_ctrl";
		reg = <0x0 0x16001000 0x0 0x1000>;
	};

	venc_gcon@17000000 {
		compatible = "mediatek,venc_gcon", "syscon";
		reg = <0x0 0x17000000 0x0 0x1000 0x0 0x17020000 0x0 0x1000>;
		mediatek,larb = <0x5f>;
		interrupts = <0x0 0xf3 0x8>;
		mediatek,vcu = <0x5d>;
		clocks = <0x22 0x3 0x22 0xb 0x60 0x1>;
		clock-names = "MT_SCP_SYS_DIS", "MT_SCP_SYS_VEN", "MT_CG_VENC";
		#clock-cells = <0x1>;
		phandle = <0x60>;
	};

	smi_larb4@17010000 {
		compatible = "mediatek,smi_larb4", "mediatek,smi_larb";
		reg = <0x0 0x17010000 0x0 0x1000>;
		mediatek,smi-id = <0x4>;
		clocks = <0x22 0xb 0x24 0x1a 0x60 0x1 0x60 0x2>;
		clock-names = "scp-venc", "mm-venc", "venc-venc", "venc-jpgenc";
		phandle = <0x5f>;
	};

	venc@17020000 {
		compatible = "mediatek,venc";
		reg = <0x0 0x17020000 0x0 0x10000>;
		interrupts = <0x0 0xf3 0x8>;
	};

	venc_jpg@17030000 {
		compatible = "mediatek,venc_jpg";
		reg = <0x0 0x17030000 0x0 0x10000>;
		interrupts = <0x0 0xf5 0x8>;
		clocks = <0x60 0x2>;
		clock-names = "MT_CG_VENC_JPGENC";
	};

	mbist@17040000 {
		compatible = "mediatek,mbist";
		reg = <0x0 0x17040000 0x0 0x10000>;
	};

	mbist@17050000 {
		compatible = "mediatek,mbist";
		reg = <0x0 0x17050000 0x0 0x10000>;
	};

	mbist@17060000 {
		compatible = "mediatek,mbist";
		reg = <0x0 0x17060000 0x0 0x10000>;
	};

	mbist@17070000 {
		compatible = "mediatek,mbist";
		reg = <0x0 0x17070000 0x0 0x10000>;
	};

	wifi@18000000 {
		compatible = "mediatek,wifi";
		reg = <0x0 0x18000000 0x0 0x100000>;
		interrupts = <0x0 0x11d 0x8>;
		memory-region = <0x61>;
		phandle = <0xcc>;
	};

	camsys@1a000000 {
		compatible = "mediatek,camsys", "syscon";
		reg = <0x0 0x1a000000 0x0 0x1000>;
		#clock-cells = <0x1>;
		phandle = <0x5b>;
	};

	smi_larb3@1a002000 {
		compatible = "mediatek,smi_larb3", "mediatek,smi_larb";
		reg = <0x0 0x1a002000 0x0 0x1000>;
		mediatek,smi-id = <0x3>;
		clocks = <0x22 0xa 0x24 0x19 0x5b 0x0>;
		clock-names = "scp-cam", "mm-cam", "cam-larb3";
		phandle = <0xcd>;
	};

	cam1@1a003000 {
		compatible = "mediatek,cam1";
		reg = <0x0 0x1a003000 0x0 0x1000>;
		interrupts = <0x0 0xfa 0x8>;
	};

	cam2@1a004000 {
		compatible = "mediatek,cam2";
		reg = <0x0 0x1a004000 0x0 0x1000>;
		interrupts = <0x0 0xfb 0x8>;
	};

	cam3@1a005000 {
		compatible = "mediatek,cam3";
		reg = <0x0 0x1a005000 0x0 0x1000>;
		interrupts = <0x0 0xfc 0x8>;
	};

	cam_set@1a00b000 {
		compatible = "mediatek,cam_set";
		reg = <0x0 0x1a00b000 0x0 0x1000>;
	};

	cama_set@1a00c000 {
		compatible = "mediatek,cama_set";
		reg = <0x0 0x1a00c000 0x0 0x1000>;
	};

	camb_set@1a00d000 {
		compatible = "mediatek,camb_set";
		reg = <0x0 0x1a00d000 0x0 0x1000>;
	};

	cam_inner@1a013000 {
		compatible = "mediatek,cam_inner";
		reg = <0x0 0x1a013000 0x0 0x1000>;
	};

	cama_inner@1a014000 {
		compatible = "mediatek,cama_inner";
		reg = <0x0 0x1a014000 0x0 0x1000>;
	};

	camb_inner@1a015000 {
		compatible = "mediatek,camb_inner";
		reg = <0x0 0x1a015000 0x0 0x1000>;
	};

	cam_clear@1a01b000 {
		compatible = "mediatek,cam_clear";
		reg = <0x0 0x1a01b000 0x0 0x1000>;
	};

	cama_clear@1a01c000 {
		compatible = "mediatek,cama_clear";
		reg = <0x0 0x1a01c000 0x0 0x1000>;
	};

	camb_clear@1a01d000 {
		compatible = "mediatek,camb_clear";
		reg = <0x0 0x1a01d000 0x0 0x1000>;
	};

	cama_ext@1a024000 {
		compatible = "mediatek,cama_ext";
		reg = <0x0 0x1a024000 0x0 0x1000>;
	};

	camb_ext@1a025000 {
		compatible = "mediatek,camb_ext";
		reg = <0x0 0x1a025000 0x0 0x1000>;
	};

	seninf1@1a040000 {
		compatible = "mediatek,seninf1";
		reg = <0x0 0x1a040000 0x0 0x1000>;
	};

	seninf2@1a041000 {
		compatible = "mediatek,seninf2";
		reg = <0x0 0x1a041000 0x0 0x1000>;
	};

	seninf3@1a042000 {
		compatible = "mediatek,seninf3";
		reg = <0x0 0x1a042000 0x0 0x1000>;
	};

	seninf4@1a043000 {
		compatible = "mediatek,seninf4";
		reg = <0x0 0x1a043000 0x0 0x1000>;
	};

	kd_camera_hw1@1a040000 {
		compatible = "mediatek,camera_hw";
		reg = <0x0 0x1a040000 0x0 0x1000>;
		clocks = <0x12 0x56 0x12 0x57 0x12 0x58 0x12 0x59 0x12 0x14 0x12 0x13 0x12 0x1d 0x12 0x11 0x12 0x1c 0x12 0x12 0x13 0x5b 0x4 0x3f 0xe 0x3f 0x12 0x62 0x0 0x63 0x0 0x64 0x0 0x65 0x0 0x66 0x0 0x67 0x0 0x12 0x6d 0x12 0x1a 0x22 0xa>;
		clock-names = "CLK_TOP_CAMTG_SEL", "CLK_TOP_CAMTG1_SEL", "CLK_TOP_CAMTG2_SEL", "CLK_TOP_CAMTG3_SEL", "CLK_MCLK_6M", "CLK_MCLK_12M", "CLK_MCLK_13M", "CLK_MCLK_48M", "CLK_MCLK_52M", "CLK_MCLK_24M", "CLK_MCLK_26M", "CLK_CAM_SENINF_CG", "CLK_MIPI_C0_26M_CG", "CLK_MIPI_C1_26M_CG", "CLK_MIPI_ANA_0A_CG", "CLK_MIPI_ANA_0B_CG", "CLK_MIPI_ANA_1A_CG", "CLK_MIPI_ANA_1B_CG", "CLK_MIPI_ANA_2A_CG", "CLK_MIPI_ANA_2B_CG", "CLK_TOP_CAMTM_SEL_CG", "CLK_TOP_CAMTM_208_CG", "CLK_SCP_SYS_CAM";
		phandle = <0xce>;
	};

	camera_af_hw_node {
		compatible = "mediatek,camera_af_lens";
		phandle = <0xcf>;
	};

	flashlight_core {
		compatible = "mediatek,flashlight_core";
		phandle = <0xd0>;
	};

	flashlights_sm5714 {
		compatible = "mediatek,flashlights_sm5714";
		decouple = <0x0>;
		phandle = <0xd1>;

		channel@1 {
			type = <0x0>;
			ct = <0x0>;
			part = <0x0>;
		};
	};

	flashlights_s2mu106 {
		compatible = "mediatek,flashlights_s2mu106";
		decouple = <0x0>;
		phandle = <0xd2>;

		channel@1 {
			type = <0x0>;
			ct = <0x0>;
			part = <0x0>;
		};
	};

	camsv1@1a050000 {
		compatible = "mediatek,camsv1";
		reg = <0x0 0x1a050000 0x0 0x1000>;
		interrupts = <0x0 0x102 0x8>;
	};

	camsv2@1a051000 {
		compatible = "mediatek,camsv2";
		reg = <0x0 0x1a051000 0x0 0x1000>;
		interrupts = <0x0 0x103 0x8>;
	};

	camsv3@1a052000 {
		compatible = "mediatek,camsv3";
		reg = <0x0 0x1a052000 0x0 0x1000>;
		interrupts = <0x0 0x100 0x8>;
	};

	camsv4@1a053000 {
		compatible = "mediatek,camsv4";
		reg = <0x0 0x1a053000 0x0 0x1000>;
		interrupts = <0x0 0x101 0x8>;
	};

	ccu@1a0b1000 {
		compatible = "mediatek,ccu";
		reg = <0x0 0x1a0b1000 0x0 0x10000>;
		interrupts = <0x0 0x105 0x8>;
		clocks = <0x5b 0x8 0x22 0xa>;
		clock-names = "CCU_CLK_CAM_CCU", "CAM_PWR";
	};

	atf_logger {
		compatible = "mediatek,atf_logger";
		interrupts = <0x0 0x128 0x1>;
	};

	amms_control {
		compatible = "mediatek,amms";
		interrupts = <0x0 0x131 0x1>;
	};

	odm {
		compatible = "simple-bus";
		phandle = <0xd3>;
	};

	memory-ssmr-features {
		compatible = "mediatek,memory-ssmr-features";
		svp-region-based-size = <0x0 0x12000000>;
		iris-recognition-size = <0x0 0x10000000>;
		2d_fr-size = <0x0 0x0>;
		tui-size = <0x0 0x4000000>;
		wfd-size = <0x0 0x6000000>;
		prot-region-based-size = <0x0 0xc000000>;
		ta-elf-size = <0x0 0x1000000>;
		ta-stack-heap-size = <0x0 0x6000000>;
		sdsp-tee-sharedmem-size = <0x0 0x1000000>;
		sdsp-firmware-size = <0x0 0x1000000>;
		phandle = <0xd4>;
	};

	radio_md_cfg {
		compatible = "mediatek,radio_md_cfg";
		phandle = <0xd5>;
	};

	mt_charger {
		compatible = "mediatek,mt-charger";
		phandle = <0xd6>;
	};

	lk_charger {
		compatible = "mediatek,lk_charger";
		enable_anime;
		enable_pd20_reset;
		power_path_support;
		max_charger_voltage = <0x632ea0>;
		fast_charge_voltage = <0x2dc6c0>;
		usb_charger_current = <0x7a120>;
		ac_charger_current = <0x1f47d0>;
		ac_charger_input_current = <0x30d400>;
		non_std_ac_charger_current = <0x7a120>;
		charging_host_charger_current = <0x16e360>;
		ta_ac_charger_current = <0x2dc6c0>;
		pd_charger_current = <0x7a120>;
		temp_t4_threshold = <0x32>;
		temp_t3_threshold = <0x2d>;
		temp_t1_threshold = <0x0>;
		phandle = <0xd7>;
	};

	charger {
		compatible = "mediatek,charger";
		algorithm_name = "SwitchCharging";
		enable_type_c;
		power_path_support;
		enable_dynamic_mivr;
		disable_pd_dual;
		battery_cv = <0x426030>;
		max_charger_voltage = <0x632ea0>;
		min_charger_voltage = <0x4630c0>;
		min_charger_voltage_1 = <0x432380>;
		min_charger_voltage_2 = <0x401640>;
		max_dmivr_charger_current = <0x155cc0>;
		usb_charger_current_suspend = <0x0>;
		usb_charger_current_unconfigured = <0x11170>;
		usb_charger_current_configured = <0x7a120>;
		usb_charger_current = <0x7a120>;
		ac_charger_current = <0x1f47d0>;
		ac_charger_input_current = <0x30d400>;
		non_std_ac_charger_current = <0x7a120>;
		charging_host_charger_current = <0x16e360>;
		apple_1_0a_charger_current = <0x9eb10>;
		apple_2_1a_charger_current = <0xc3500>;
		ta_ac_charger_current = <0x2dc6c0>;
		jeita_temp_above_t4_cv = <0x40b280>;
		jeita_temp_t3_to_t4_cv = <0x40b280>;
		jeita_temp_t2_to_t3_cv = <0x423920>;
		jeita_temp_t1_to_t2_cv = <0x40b280>;
		jeita_temp_t0_to_t1_cv = <0x3da540>;
		jeita_temp_below_t0_cv = <0x3da540>;
		temp_t4_thres = <0x32>;
		temp_t4_thres_minus_x_degree = <0x2f>;
		temp_t3_thres = <0x2d>;
		temp_t3_thres_minus_x_degree = <0x27>;
		temp_t2_thres = <0xa>;
		temp_t2_thres_plus_x_degree = <0x10>;
		temp_t1_thres = <0x0>;
		temp_t1_thres_plus_x_degree = <0x6>;
		temp_t0_thres = <0x0>;
		temp_t0_thres_plus_x_degree = <0x0>;
		temp_neg_10_thres = <0x0>;
		enable_min_charge_temp;
		min_charge_temp = <0x0>;
		min_charge_temp_plus_x_degree = <0x6>;
		max_charge_temp = <0x32>;
		max_charge_temp_minus_x_degree = <0x2f>;
		ta_12v_support;
		ta_9v_support;
		pe_ichg_level_threshold = <0xf4240>;
		ta_ac_12v_input_current = <0x30d400>;
		ta_ac_9v_input_current = <0x30d400>;
		ta_ac_7v_input_current = <0x30d400>;
		pe20_ichg_level_threshold = <0xf4240>;
		ta_start_battery_soc = <0x0>;
		ta_stop_battery_soc = <0x55>;
		high_temp_to_leave_pe40 = <0x2e>;
		high_temp_to_enter_pe40 = <0x27>;
		low_temp_to_leave_pe40 = <0xa>;
		low_temp_to_enter_pe40 = <0x10>;
		pe40_single_charger_input_current = <0x2dc6c0>;
		pe40_single_charger_current = <0x2dc6c0>;
		pe40_dual_charger_input_current = <0x2dc6c0>;
		pe40_dual_charger_chg1_current = <0x1e8480>;
		pe40_dual_charger_chg2_current = <0x1e8480>;
		pe40_stop_battery_soc = <0x50>;
		pe40_r_cable_1a_lower = <0x206>;
		pe40_r_cable_2a_lower = <0x17f>;
		pe40_r_cable_3a_lower = <0xf5>;
		chg1_ta_ac_charger_current = <0x16e360>;
		chg2_ta_ac_charger_current = <0x16e360>;
		slave_mivr_diff = <0x186a0>;
		dual_polling_ieoc = <0x6ddd0>;
		cable_imp_threshold = <0x2bb>;
		vbat_cable_imp_threshold = <0x3b8260>;
		bif_threshold1 = <0x40d990>;
		bif_threshold2 = <0x419ce0>;
		bif_cv_under_threshold2 = <0x43e6d0>;
		pd_vbus_low_bound = <0x4c4b40>;
		pd_vbus_upper_bound = <0x4c4b40>;
		pd_ichg_level_threshold = <0xf4240>;
		pd_stop_battery_soc = <0x50>;
		ibus_err = <0xe>;
		vsys_watt = <0x4c4b40>;
		phandle = <0xd8>;
	};

	pd_adapter {
		compatible = "mediatek,pd_adapter";
		adapter_name = "pd_adapter";
		phandle = <0xd9>;
	};

	rt9465_slave_chr {
		compatible = "richtek,rt9465";
		phandle = <0xda>;
	};

	rt-pd-manager {
		compatible = "mediatek,rt-pd-manager";
	};

	mt6370_pmu_eint {
		phandle = <0xdb>;
	};

	tcpc_pd_eint {
		phandle = <0xdc>;
	};

	irtx_pwm {
		compatible = "mediatek,irtx-pwm";
		pwm_ch = <0x0>;
		pwm_data_invert = <0x0>;
		phandle = <0xdd>;
	};

	pmic_clock_buffer_ctrl {
		compatible = "mediatek,pmic_clock_buffer";
		mediatek,clkbuf-quantity = <0x7>;
		mediatek,clkbuf-config = <0x2 0x1 0x1 0x2 0x0 0x0 0x0>;
		mediatek,clkbuf-driving-current = <0x1 0x1 0x1 0x1 0x1 0x1 0x1>;
		phandle = <0xde>;
	};

	touch {
		compatible = "goodix,touch";
		phandle = <0xdf>;
	};

	smart_pa {
		phandle = <0xe0>;
	};

	gpio {
		compatible = "mediatek,gpio_usage_mapping";
		phandle = <0xe1>;
	};

	md1_sim1_hot_plug_eint {
		phandle = <0xe2>;
	};

	md1_sim2_hot_plug_eint {
		phandle = <0xe3>;
	};

	mt6370_pmu_dts {
		interrupt-controller;
		#interrupt-cells = <0x1>;
		mt6370,intr_gpio_num = <0x3>;
		mt6370,intr_gpio = <0x1e 0x3 0x0>;
		phandle = <0xe4>;

		core {
			compatible = "mediatek,mt6370_pmu_core";
			interrupt-names = "otp", "vdda_ovp", "vdda_uv";
			i2cstmr_rst_tmr = <0x0>;
			mrstb_en;
			mrstb_tmr = <0x3>;
			int_wdt = <0x0>;
			int_deg = <0x0>;
		};

		charger {
			compatible = "mediatek,mt6370_pmu_charger";
			interrupt-names = "chg_mivr", "chg_aiclmeasi", "attachi", "ovpctrl_uvp_d_evt", "chg_wdtmri", "chg_vbusov", "chg_tmri", "chg_treg", "dcdti";
			charger_name = "primary_chg";
			load_switch_name = "primary_load_switch";
			ichg = <0x1e8480>;
			aicr = <0x7a120>;
			mivr = <0x432380>;
			cv = <0x426030>;
			ieoc = <0x249f0>;
			safety_timer = <0xc>;
			dc_wdt = <0x3d0900>;
			ircmp_resistor = <0x61a8>;
			ircmp_vclamp = <0x7d00>;
			enable_te;
			enable_wdt;
			enable_otg_wdt;
			lbp_hys_sel = <0x1>;
			lbp_dt = <0x1>;
			fast_unknown_ta_dect;
		};

		mt6370_pmu_fled1 {
			compatible = "mediatek,mt6370_pmu_fled1";
			interrupt-names = "fled_lvf", "fled2_short", "fled1_short";
			fled_enable = <0x1>;
			torch_cur = <0x493e0>;
			strobe_cur = <0x124f80>;
			strobe_timeout = <0x960>;
		};

		mt6370_pmu_fled2 {
			compatible = "mediatek,mt6370_pmu_fled2";
			fled_enable = <0x1>;
			torch_cur = <0x30d40>;
			strobe_cur = <0xf4240>;
			strobe_timeout = <0x4b0>;
		};

		ldo {
			compatible = "mediatek,mt6370_pmu_ldo";
			interrupt-names = "ldo_oc";
			ldo_oms = <0x1>;
			ldo_vrc_lt = <0x1>;

			mt6370_ldo {
				regulator-name = "irtx_ldo";
				regulator-min-microvolt = <0x186a00>;
				regulator-max-microvolt = <0x3d0900>;
			};
		};

		rgbled {
			compatible = "mediatek,mt6370_pmu_rgbled";
			interrupt-names = "isink4_short", "isink3_short", "isink2_short", "isink1_short", "isink4_open", "isink3_open", "isink2_open", "isink1_open";
			mt,led_name = "mt6370_pmu_led1", "mt6370_pmu_led2", "mt6370_pmu_led3", "mt6370_pmu_led4";
			mt,led_default_trigger = "cc_mode", "cc_mode", "cc_mode", "none";
		};

		bled {
			compatible = "mediatek,mt6370_pmu_bled";
			interrupt-names = "bled_ocp";
			mt,bled_name = "mt6370_pmu_bled";
			mt,chan_en = <0xf>;
			mt,map_linear;
			mt,bl_ovp_level = <0x3>;
			mt,bl_ocp_level = <0x2>;
			mt,use_pwm;
			mt,pwm_fsample = <0x2>;
			mt,pwm_deglitch = <0x1>;
			mt,pwm_hys_en = <0x1>;
			mt,pwm_hys = <0x0>;
			mt,pwm_avg_cycle = <0x0>;
			mt,bled_ramptime = <0x3>;
			mt,bled_flash_ramp = <0x1>;
			mt,max_bled_brightness = <0x200>;
			mt,bled_curr_scale = <0x0>;
			mt,pwm_lpf_coef = <0x0>;
		};

		dsv {
			compatible = "mediatek,mt6370_pmu_dsv";
			interrupt-names = "dsv_vneg_ocp", "dsv_vpos_ocp", "dsv_bst_ocp", "dsv_vneg_scp", "dsv_vpos_scp";
			db_ext_en = <0x0>;
			db_periodic_fix = <0x0>;
			db_single_pin = <0x0>;
			db_freq_pm = <0x0>;
			db_periodic_mode = <0x0>;
			db_startup = <0x0>;
			db_vneg_20ms = <0x1>;
			db_vneg_disc = <0x0>;
			db_vpos_20ms = <0x1>;
			db_vpos_disc = <0x1>;
			db_delay = <0x3>;
			db_vbst = <0x1644>;
			db_vpos_slew = <0x1>;
			db_vneg_slew = <0x1>;

			mt6370_dsvp {
				regulator-name = "dsv_pos";
				regulator-min-microvolt = <0x3d0900>;
				regulator-max-microvolt = <0x5b8d80>;
			};

			mt6370_dsvn {
				regulator-name = "dsv_neg";
				regulator-min-microvolt = <0x3d0900>;
				regulator-max-microvolt = <0x5b8d80>;
			};
		};
	};

	type_c_port0 {
		mt-tcpc,name = "type_c_port0";
		mt-tcpc,role_def = <0x5>;
		mt-tcpc,rp_level = <0x1>;
		mt-tcpc,vconn_supply = <0x1>;
		mt-tcpc,notifier_supply_num = <0x2>;
		mt6370pd,intr_gpio = <0x1e 0x18 0x0>;
		mt6370pd,intr_gpio_num = <0x18>;
		phandle = <0xe5>;

		pd-data {
			pd,vid = <0x29cf>;
			pd,pid = <0x5081>;
			pd,source-cap-ext = <0x508129cf 0x0 0x0 0x0 0x0 0x7000000>;
			pd,mfrs = "RichtekTCPC";
			pd,charging_policy = <0x31>;
			pd,source-pdo-size = <0x1>;
			pd,source-pdo-data = <0x19096>;
			pd,sink-pdo-size = <0x1>;
			pd,sink-pdo-data = <0x190c8>;
			pd,id-vdo-size = <0x6>;
			pd,id-vdo-data = <0xd14029cf 0x0 0x50810000 0x41800000 0x0 0x21800000>;
			bat,nr = <0x1>;
			pd,country_nr = <0x0>;

			bat-info0 {
				bat,vid = <0x29cf>;
				bat,pid = <0x5081>;
				bat,mfrs = "bat1";
				bat,design_cap = <0xbb8>;
			};
		};

		dpm_caps {
			local_dr_power;
			local_dr_data;
			local_usb_comm;
			local_no_suspend;
			local_vconn_supply;
			attemp_enter_dp_mode;
			attemp_discover_cable;
			attemp_discover_id;
			pr_check = <0x0>;
			dr_check = <0x0>;
		};

		displayport {
			1st_connection = "dfp_d";
			2nd_connection = "dfp_d";
			signal,dp_v13;
			typec,receptacle;

			ufp_d {
			};

			dfp_d {
				pin_assignment,mode_c;
				pin_assignment,mode_d;
				pin_assignment,mode_e;
			};
		};
	};

	trusty {
		compatible = "android,trusty-smc-v1";
		ranges;
		#address-cells = <0x2>;
		#size-cells = <0x2>;
		tee-id = <0x0>;
		tee-name = "trusty";

		mtee {
			compatible = "mediatek,trusty-mtee-v1";
		};

		gz-main {
			compatible = "mediatek,trusty-gz";
		};

		trusty-irq {
			compatible = "android,trusty-irq-v1";
			ppi-interrupt-parent = <0x11>;
		};

		trusty-virtio {
			compatible = "android,trusty-virtio-v1";
		};

		trusty-gz-log {
			compatible = "android,trusty-gz-log-v1";
		};
	};

	nebula {
		compatible = "android,nebula-smc-v1";
		ranges;
		#address-cells = <0x2>;
		#size-cells = <0x2>;
		tee-id = <0x1>;
		tee-name = "nebula";

		nebula-virtio {
			compatible = "android,nebula-virtio-v1";
		};

		nebula-irq {
			compatible = "android,nebula-irq-v1";
			ppi-interrupt-parent = <0x11>;
		};

		nebula-gz-log {
			compatible = "android,nebula-gz-log-v1";
		};
	};

	mif_pdata {
		compatible = "sec_modem,modem_pdata";
		status = "okay";
		mif,name = "MT6769ap";
		mif,modem_net = <0x0>;
		mif,modem_type = <0xa>;
		mif,use_handover = <0x0>;
		mif,ipc_version = <0x32>;
		mif,link_types = <0x200>;
		mif,link_name = "shmem";
		mif,link_attrs = <0x7c8>;
		mif,num_iodevs = <0x5>;

		iodevs {

			io_device_0 {
				iod,name = "umts_boot0";
				iod,id = <0xec>;
				iod,minor = <0x1e>;
				iod,format = <0x0>;
				iod,io_type = <0x0>;
				iod,links = <0x200>;
				iod,attrs = <0x2>;
				iod,app = "RIL";
			};

			io_device_1 {
				iod,name = "umts_ipc0";
				iod,id = <0xec>;
				iod,minor = <0x1c>;
				iod,format = <0x0>;
				iod,io_type = <0x0>;
				iod,links = <0x200>;
				iod,attrs = <0x2>;
				iod,app = "RIL";
			};

			io_device_2 {
				iod,name = "umts_ipc1";
				iod,id = <0xec>;
				iod,minor = <0x1d>;
				iod,format = <0x0>;
				iod,io_type = <0x0>;
				iod,links = <0x200>;
				iod,attrs = <0x2>;
				iod,app = "RIL";
			};

			io_device_3 {
				iod,name = "umts_router";
				iod,id = <0xec>;
				iod,minor = <0x3>;
				iod,format = <0x1>;
				iod,io_type = <0x0>;
				iod,links = <0x200>;
				iod,attrs = <0x2>;
				iod,app = "smdexe";
			};

			io_device_4 {
				iod,name = "umts_csd";
				iod,minor = <0x1e>;
				iod,format = <0x1>;
				iod,io_type = <0x0>;
				iod,links = <0x200>;
				iod,attrs = <0x2>;
				iod,app = "CSVT";
			};
		};
	};

	dev_ril_bridge_pdata {
		compatible = "samsung,dev_ril_bridge_pdata";
		status = "okay";
	};

	__symbols__ {
		chosen = "/chosen";
		cpu0 = "/cpus/cpu@000";
		cpu1 = "/cpus/cpu@001";
		cpu2 = "/cpus/cpu@002";
		cpu3 = "/cpus/cpu@003";
		cpu4 = "/cpus/cpu@100";
		cpu5 = "/cpus/cpu@101";
		cpu6 = "/cpus/cpu@102";
		cpu7 = "/cpus/cpu@103";
		doe_dvfs_cl0 = "/cpus/cpu-map/cluster0/doe";
		doe_dvfs_cl1 = "/cpus/cpu-map/cluster1/doe";
		STANDBY = "/cpus/idle-states/standby";
		MCDI_CPU = "/cpus/idle-states/mcdi-cpu";
		MCDI_CLUSTER = "/cpus/idle-states/mcdi-cluster";
		idledram = "/cpus/idle-states/idledram";
		idlesyspll = "/cpus/idle-states/idlesyspll";
		idlebus26m = "/cpus/idle-states/idlebus26m";
		SUSPEND = "/cpus/idle-states/suspend";
		reserved_memory = "/reserved-memory";
		wifi_mem = "/reserved-memory/wifi-reserve-memory";
		cpu_dbgapb = "/cpu_dbgapb@0e010000";
		gic = "/interrupt-controller";
		sysirq = "/intpol-controller@0";
		timer = "/timer";
		infracfg_ao = "/infracfg_ao@10001000";
		scpsys = "/scpsys@10001000";
		mcdi = "/mcdi@0010fc00";
		topckgen = "/topckgen@10000000";
		io_cfg_lt = "/io_cfg_lt@10002000";
		io_cfg_lm = "/io_cfg_lm@10002200";
		io_cfg_lb = "/io_cfg_lb@10002400";
		io_cfg_bl = "/io_cfg_bl@10002600";
		io_cfg_rm = "/io_cfg_rm@10002800";
		io_cfg_rb = "/io_cfg_rb@10002a00";
		io_cfg_rt = "/io_cfg_rt@10002c00";
		io_cfg_tl = "/io_cfg_tl@10002e00";
		pericfg = "/pericfg@10003000";
		gpio = "/gpio@10005000";
		pio = "/pinctrl";
		aud_clk_mosi_off = "/pinctrl/aud_clk_mosi_off";
		aud_clk_mosi_on = "/pinctrl/aud_clk_mosi_on";
		aud_clk_miso_off = "/pinctrl/aud_clk_miso_off";
		aud_clk_miso_on = "/pinctrl/aud_clk_miso_on";
		aud_dat_mosi_off = "/pinctrl/aud_dat_mosi_off";
		aud_dat_mosi_on = "/pinctrl/aud_dat_mosi_on";
		aud_dat_miso_off = "/pinctrl/aud_dat_miso_off";
		aud_dat_miso_on = "/pinctrl/aud_dat_miso_on";
		aud_gpio_i2s0_off = "/pinctrl/aud_gpio_i2s0_off";
		aud_gpio_i2s0_on = "/pinctrl/aud_gpio_i2s0_on";
		aud_gpio_i2s1_off = "/pinctrl/aud_gpio_i2s1_off";
		aud_gpio_i2s1_on = "/pinctrl/aud_gpio_i2s1_on";
		aud_gpio_i2s2_off = "/pinctrl/aud_gpio_i2s2_off";
		aud_gpio_i2s2_on = "/pinctrl/aud_gpio_i2s2_on";
		aud_gpio_i2s3_off = "/pinctrl/aud_gpio_i2s3_off";
		aud_gpio_i2s3_on = "/pinctrl/aud_gpio_i2s3_on";
		vow_dat_miso_off = "/pinctrl/vow_dat_miso_off";
		vow_dat_miso_on = "/pinctrl/vow_dat_miso_on";
		vow_clk_miso_off = "/pinctrl/vow_clk_miso_off";
		vow_clk_miso_on = "/pinctrl/vow_clk_miso_on";
		msdc0_pins_default = "/pinctrl/msdc0@default";
		msdc0_pins_hs400 = "/pinctrl/msdc0@hs400";
		msdc0_pins_hs200 = "/pinctrl/msdc0@hs200";
		msdc0_register_setting_default = "/pinctrl/msdc0@register_default";
		msdc1_pins_default = "/pinctrl/msdc1@default";
		msdc1_pins_sdr104 = "/pinctrl/msdc1@sdr104";
		msdc1_pins_sdr50 = "/pinctrl/msdc1@sdr50";
		msdc1_pins_ddr50 = "/pinctrl/msdc1@ddr50";
		msdc1_register_setting_default = "/pinctrl/msdc1@register_default";
		sleep = "/sleep@10006000";
		toprgu = "/toprgu@10007000";
		clk26m = "/clocks/clk26m";
		clk32k = "/clocks/clk32k";
		dcm = "/dcm";
		eint = "/apirq@1000b000";
		apmixed = "/apmixed@1000c000";
		pwrap = "/pwrap@1000d000";
		main_pmic = "/pwrap@1000d000/mt6358-pmic";
		pmic = "/pwrap@1000d000/mt6358-pmic/mt-pmic";
		pmic_auxadc = "/pwrap@1000d000/mt6358-pmic/mt635x-auxadc";
		mt6358regulator = "/pwrap@1000d000/mt6358-pmic/mt6358regulator";
		mt_pmic_vdram1_buck_reg = "/pwrap@1000d000/mt6358-pmic/mt6358regulator/buck_vdram1";
		mt_pmic_vcore_buck_reg = "/pwrap@1000d000/mt6358-pmic/mt6358regulator/buck_vcore";
		mt_pmic_vpa_buck_reg = "/pwrap@1000d000/mt6358-pmic/mt6358regulator/buck_vpa";
		mt_pmic_vproc11_buck_reg = "/pwrap@1000d000/mt6358-pmic/mt6358regulator/buck_vproc11";
		mt_pmic_vproc12_buck_reg = "/pwrap@1000d000/mt6358-pmic/mt6358regulator/buck_vproc12";
		mt_pmic_vgpu_buck_reg = "/pwrap@1000d000/mt6358-pmic/mt6358regulator/buck_vgpu";
		mt_pmic_vs2_buck_reg = "/pwrap@1000d000/mt6358-pmic/mt6358regulator/buck_vs2";
		mt_pmic_vmodem_buck_reg = "/pwrap@1000d000/mt6358-pmic/mt6358regulator/buck_vmodem";
		mt_pmic_vs1_buck_reg = "/pwrap@1000d000/mt6358-pmic/mt6358regulator/buck_vs1";
		mt_pmic_vdram2_ldo_reg = "/pwrap@1000d000/mt6358-pmic/mt6358regulator/ldo_vdram2";
		mt_pmic_vsim1_ldo_reg = "/pwrap@1000d000/mt6358-pmic/mt6358regulator/ldo_vsim1";
		mt_pmic_vibr_ldo_reg = "/pwrap@1000d000/mt6358-pmic/mt6358regulator/ldo_vibr";
		mt_pmic_vrf12_ldo_reg = "/pwrap@1000d000/mt6358-pmic/mt6358regulator/ldo_vrf12";
		mt_pmic_vio18_ldo_reg = "/pwrap@1000d000/mt6358-pmic/mt6358regulator/ldo_vio18";
		mt_pmic_vusb_ldo_reg = "/pwrap@1000d000/mt6358-pmic/mt6358regulator/ldo_vusb";
		mt_pmic_vcamio_ldo_reg = "/pwrap@1000d000/mt6358-pmic/mt6358regulator/ldo_vcamio";
		mt_pmic_vcamd_ldo_reg = "/pwrap@1000d000/mt6358-pmic/mt6358regulator/ldo_vcamd";
		mt_pmic_vcn18_ldo_reg = "/pwrap@1000d000/mt6358-pmic/mt6358regulator/ldo_vcn18";
		mt_pmic_vfe28_ldo_reg = "/pwrap@1000d000/mt6358-pmic/mt6358regulator/ldo_vfe28";
		mt_pmic_vsram_proc11_ldo_reg = "/pwrap@1000d000/mt6358-pmic/mt6358regulator/ldo_vsram_proc11";
		mt_pmic_vcn28_ldo_reg = "/pwrap@1000d000/mt6358-pmic/mt6358regulator/ldo_vcn28";
		mt_pmic_vsram_others_ldo_reg = "/pwrap@1000d000/mt6358-pmic/mt6358regulator/ldo_vsram_others";
		mt_pmic_vsram_gpu_ldo_reg = "/pwrap@1000d000/mt6358-pmic/mt6358regulator/ldo_vsram_gpu";
		mt_pmic_vxo22_ldo_reg = "/pwrap@1000d000/mt6358-pmic/mt6358regulator/ldo_vxo22";
		mt_pmic_vefuse_ldo_reg = "/pwrap@1000d000/mt6358-pmic/mt6358regulator/ldo_vefuse";
		mt_pmic_vaux18_ldo_reg = "/pwrap@1000d000/mt6358-pmic/mt6358regulator/ldo_vaux18";
		mt_pmic_vmch_ldo_reg = "/pwrap@1000d000/mt6358-pmic/mt6358regulator/ldo_vmch";
		mt_pmic_vbif28_ldo_reg = "/pwrap@1000d000/mt6358-pmic/mt6358regulator/ldo_vbif28";
		mt_pmic_vsram_proc12_ldo_reg = "/pwrap@1000d000/mt6358-pmic/mt6358regulator/ldo_vsram_proc12";
		mt_pmic_vcama1_ldo_reg = "/pwrap@1000d000/mt6358-pmic/mt6358regulator/ldo_vcama1";
		mt_pmic_vemc_ldo_reg = "/pwrap@1000d000/mt6358-pmic/mt6358regulator/ldo_vemc";
		mt_pmic_vio28_ldo_reg = "/pwrap@1000d000/mt6358-pmic/mt6358regulator/ldo_vio28";
		mt_pmic_va12_ldo_reg = "/pwrap@1000d000/mt6358-pmic/mt6358regulator/ldo_va12";
		mt_pmic_vrf18_ldo_reg = "/pwrap@1000d000/mt6358-pmic/mt6358regulator/ldo_vrf18";
		mt_pmic_vcn33_bt_ldo_reg = "/pwrap@1000d000/mt6358-pmic/mt6358regulator/ldo_vcn33_bt";
		mt_pmic_vcn33_wifi_ldo_reg = "/pwrap@1000d000/mt6358-pmic/mt6358regulator/ldo_vcn33_wifi";
		mt_pmic_vcama2_ldo_reg = "/pwrap@1000d000/mt6358-pmic/mt6358regulator/ldo_vcama2";
		mt_pmic_vmc_ldo_reg = "/pwrap@1000d000/mt6358-pmic/mt6358regulator/ldo_vmc";
		mt_pmic_vldo28_ldo_reg = "/pwrap@1000d000/mt6358-pmic/mt6358regulator/ldo_vldo28";
		mt_pmic_vaud28_ldo_reg = "/pwrap@1000d000/mt6358-pmic/mt6358regulator/ldo_vaud28";
		mt_pmic_vsim2_ldo_reg = "/pwrap@1000d000/mt6358-pmic/mt6358regulator/ldo_vsim2";
		mt_pmic_va09_ldo_reg = "/pwrap@1000d000/mt6358-pmic/mt6358regulator/ldo_va09";
		mt6358_rtc = "/pwrap@1000d000/mt6358-pmic/mt6358_rtc";
		mt6358_misc = "/pwrap@1000d000/mt6358-pmic/mt6358_misc";
		pwraph = "/pwraphal@";
		keypad = "/kp@10010000";
		mrdump_ext_rst = "/mrdump_ext_rst";
		dvfsrc = "/dvfsrc@10012000";
		mcucfg = "/mcucfg@0c530000";
		hwrng = "/hwrng";
		mdcldma = "/mdcldma@10014000";
		md_auxadc = "/md_auxadc";
		dvfsp = "/dvfsp@00110800";
		mt_cpufreq = "/mt_cpufreq";
		gce = "/gce@10238000";
		gce_mbox = "/gce_mbox@10238000";
		gce_mbox_bdg = "/gce_mbox_bdg";
		gce_mbox_svp = "/gce_mbox_svp@10238000";
		goodix_fp = "/fingerprint";
		accdet = "/accdet";
		dfd_cache = "/dfd_cache";
		auxadc = "/auxadc@11001000";
		apdma = "/dma-controller@11000980";
		apuart0 = "/serial@11002000";
		apuart1 = "/serial@11003000";
		i2c_common = "/i2c_common";
		i2c0 = "/i2c0@11007000";
		i2c1 = "/i2c1@11008000";
		i2c2 = "/i2c2@11009000";
		i2c3 = "/i2c3@1100f000";
		i2c4 = "/i2c4@11011000";
		i2c5 = "/i2c5@11016000";
		i2c6 = "/i2c6@1100d000";
		i2c7 = "/i2c7@11004000";
		speaker_amp = "/i2c7@11004000/speaker_amp@34";
		i2c8 = "/i2c8@11005000";
		spi0 = "/spi0@1100a000";
		eem_fsm = "/eem_fsm@1100b000";
		tboard_thermistor1 = "/thermal-sensor1";
		tboard_thermistor2 = "/thermal-sensor2";
		drcc = "/drcc";
		consys = "/consys@18002000";
		spi1 = "/spi1@11010000";
		spi2 = "/spi2@11012000";
		spi3 = "/spi3@11013000";
		spi4 = "/spi4@11014000";
		spi5 = "/spi5@11015000";
		usb_tuning = "/usb_tuning";
		msdc0 = "/msdc@11230000";
		msdc1 = "/msdc@11240000";
		audio = "/audio@11220000";
		afe = "/mt6768-afe-pcm@11220000";
		mt6358_snd = "/mt6358_snd";
		sound = "/sound";
		snd_scp_spk = "/snd_scp_spk";
		mipi_rx_ana_csi0a = "/mipi_rx_ana_csi0a@11c10000";
		mipi_rx_ana_csi0b = "/mipi_rx_ana_csi0b@11c11000";
		mipi_rx_ana_csi1a = "/mipi_rx_ana_csi1a@11c12000";
		mipi_rx_ana_csi1b = "/mipi_rx_ana_csi1b@11c13000";
		mipi_rx_ana_csi2a = "/mipi_rx_ana_csi2a@11c14000";
		mipi_rx_ana_csi2b = "/mipi_rx_ana_csi2b@11c15000";
		mfg_cfg = "/mfg_cfg@13000000";
		mmsys_config = "/mmsys_config@14000000";
		disp_mutex0 = "/disp_mutex0@14001000";
		smi_larb0 = "/smi_larb0@14003000";
		mdp_rdma0 = "/mdp_rdma0@14004000";
		mdp_ccorr = "/mdp_ccorr0@14005000";
		mdp_rsz0 = "/mdp_rsz0@14006000";
		mdp_rsz1 = "/mdp_rsz1@14007000";
		mdp_wdma0 = "/mdp_wdma0@14008000";
		mdp_wrot0 = "/mdp_wrot0@14009000";
		mdp_tdshp0 = "/mdp_tdshp0@1400a000";
		disp_color0 = "/disp_color0@1400f000";
		mtkfb = "/mtkfb@0";
		dsi_te = "/dsi_te";
		imgsys = "/imgsys@15020000";
		smi_larb2 = "/smi_larb2@15021000";
		vcu = "/vcu@16000000";
		vdec_gcon = "/vdec_gcon@16000000";
		smi_larb1 = "/smi_larb1@16010000";
		venc_gcon = "/venc_gcon@17000000";
		smi_larb4 = "/smi_larb4@17010000";
		wifi = "/wifi@18000000";
		camsys = "/camsys@1a000000";
		smi_larb3 = "/smi_larb3@1a002000";
		kd_camera_hw1 = "/kd_camera_hw1@1a040000";
		camera_af_hw_node = "/camera_af_hw_node";
		flashlight_core = "/flashlight_core";
		flashlights_sm5714 = "/flashlights_sm5714";
		flashlights_s2mu106 = "/flashlights_s2mu106";
		odm = "/odm";
		memory_ssmr_features = "/memory-ssmr-features";
		radio_md_cfg = "/radio_md_cfg";
		mt_charger = "/mt_charger";
		lk_charger = "/lk_charger";
		charger = "/charger";
		pd_adapter = "/pd_adapter";
		rt9465_slave_chr = "/rt9465_slave_chr";
		subpmic_pmu_eint = "/mt6370_pmu_eint";
		tcpc_pd = "/tcpc_pd_eint";
		irtx_pwm = "/irtx_pwm";
		pmic_clock_buffer_ctrl = "/pmic_clock_buffer_ctrl";
		touch = "/touch";
		smart_pa = "/smart_pa";
		gpio_usage_mapping = "/gpio";
		md1_sim1_hot_plug_eint = "/md1_sim1_hot_plug_eint";
		md1_sim2_hot_plug_eint = "/md1_sim2_hot_plug_eint";
		mt6370_pmu = "/mt6370_pmu_dts";
		mt6370_typec = "/type_c_port0";
	};
};
